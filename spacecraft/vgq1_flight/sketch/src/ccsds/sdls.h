// =============================================================================
//  Space Data Link Security (CCSDS 355.0-B-2) for the TC uplink and the TM
//  downlink. Three Security Associations are defined (managed parameters):
//
//    SPI 1  TC AUTH  HMAC-SHA-256 truncated to 128 bits, master key (v2 format)
//    SPI 2  TC AE    AES-256-GCM, K_tc_ae = HMAC-SHA-256(master, "VGQ1-SDLS-TC-AE")
//    SPI 3  TM AE    AES-256-GCM, K_tm_ae = HMAC-SHA-256(master, "VGQ1-SDLS-TM-AE")
//    SPI 0  TM null SA (fallback only): header present, IV and MAC all zero,
//           data in clear text
//
//  AUTH (unchanged, byte-exact with v2):
//    | primary hdr | SPI 2 | SN 4 | data field N | MAC 16 | FECF 2 |
//    MAC = first 16 octets of HMAC-SHA-256(key, primary hdr || security hdr || data)
//
//  AE (TC and TM) and the null SA:
//    | primary hdr | SPI 2 | IV 12 | ciphertext N | tag 16 | (OCF 4) | FECF 2 |
//    IV  = dir u16 ('TC' 0x5443 / 'TM' 0x544D) | epoch u16 | 0x00000000 | sn u32
//    AAD = primary header (TC v1: 5 octets; USLP: the TFPH incl. VCF count) || security header
//    TC: epoch 0, sn = the ground's persistent counter. TM: epoch = SCLK partition
//    from the EGSE (>= 1), sn = frame counter, restarted at 1 for each new epoch.
//
//  Anti-replay: TC sn must be strictly greater than the last accepted one (same
//  counter for AUTH and AE); TM (ground side) (epoch, sn) must increase.
//
//  Processing order on the spacecraft (as in the standard): CLTU decode ->
//  frame + FECF check -> SDLS ProcessSecurity -> FARM-1. A frame that fails
//  never touches FARM or anti-replay state (nor, for AE, its own buffer), so a
//  spoofer cannot even cause a lockout.
//
//  TM nonce safety: GCM must never see the same (key, IV) twice. The downlink
//  protector therefore refuses to protect until the EGSE has supplied an epoch,
//  accepts only increasing epochs, and after a timeout chosen by the integrator
//  falls back to the null SA (clear text, flagged) instead of guessing one.
//
//  Regulatory: encryption is generally not permitted on amateur frequencies;
//  use AUTH or NONE there (docs/09_Regulatory_and_Safety.md).
//
//  The 256-bit master key lives in src/sdls_key.h, generated by
//  tools/gen_sdls_key.py (never committed). Without it the build runs NONE on
//  both links and says so in telemetry.
// =============================================================================
#pragma once
#include "frame_security.h"
#include "gcm.h"
#include "tc.h"

namespace ccsds {

enum SdlsService : uint8_t { SDLS_SVC_NONE = 0, SDLS_SVC_AUTH = 1, SDLS_SVC_AE = 2 };

static const uint16_t kSdlsSpiNull = 0;     // TM null SA (fallback)
static const uint16_t kSdlsSpiAuth = 1;     // TC authentication (default; key header may override)
static const uint16_t kSdlsSpiTcAe = 2;     // TC authenticated encryption
static const uint16_t kSdlsSpiTmAe = 3;     // TM authenticated encryption

// AUTH layout (v2)
static const size_t kSdlsHdrLen = 6;     // SPI (2) + SN (4)
static const size_t kSdlsMacLen = 16;    // truncated HMAC-SHA-256
// AE / null-SA layout
static const size_t kSdlsIvLen = AesGcm::kIvLen;                         // 12
static const size_t kSdlsAeHdrLen = 2 + kSdlsIvLen;                      // SPI + IV = 14
static const size_t kSdlsAeTagLen = AesGcm::kTagLen;                     // 16
static const size_t kSdlsAeOverhead = kSdlsAeHdrLen + kSdlsAeTagLen;     // 30
static const uint16_t kSdlsIvDirTc = 0x5443;   // ASCII "TC"
static const uint16_t kSdlsIvDirTm = 0x544D;   // ASCII "TM"

// Key-derivation labels (ASCII, no terminator enters the MAC).
extern const char kSdlsLabelTcAe[];   // "VGQ1-SDLS-TC-AE"
extern const char kSdlsLabelTmAe[];   // "VGQ1-SDLS-TM-AE"

// out = HMAC-SHA-256(master, label).
void sdls_derive_key(const uint8_t* master, size_t master_len, const char* label, uint8_t out[32]);
// iv = dir | epoch | 0x00000000 | sn (big-endian).
void sdls_iv(uint16_t dir, uint16_t epoch, uint32_t sn, uint8_t iv[kSdlsIvLen]);

// ---------------------------------------------------------------------------
// TC receiving end (ProcessSecurity): AUTH (SPI 1) or AE (SPI 2).
// ---------------------------------------------------------------------------
class Sdls {
 public:
  enum Result : uint8_t { SDLS_OK = 0, SDLS_DISABLED, SDLS_BAD_LENGTH, SDLS_BAD_SPI,
                          SDLS_REPLAY, SDLS_BAD_MAC, SDLS_BAD_IV };
  static const char* result_name(Result r);   // "OK", "disabled", ..., "bad IV"

  // Selects the TC service. AUTH uses `master` directly with SPI `auth_spi`;
  // AE derives K_tc_ae from `master` and uses SPI 2. NONE, or no key, disables
  // SDLS. Anti-replay state and the failure counter are kept.
  void configure(uint8_t service, const uint8_t* master, size_t master_len,
                 uint16_t auth_spi = kSdlsSpiAuth);
  // v2 entry point (AUTH with this key and SPI; key_len 0 = disabled).
  void init(const uint8_t* key, size_t key_len, uint16_t spi);

  bool enabled() const { return svc_ != SDLS_SVC_NONE; }
  uint8_t service() const { return svc_; }        // SdlsService, for HK sdls_tc_service
  uint16_t spi() const { return spi_; }
  // Octets the service adds to a frame's data field (AUTH 22, AE 30, NONE 0).
  size_t overhead() const;

  // TC v1 (232.0-B-4): `frame` is the whole TC frame (writable: AE decrypts in
  // place), `f` its parse result. The AAD/MAC header is frame[0 .. f.data). On
  // SDLS_OK `f.data/f.data_len` are narrowed to the plaintext data field.
  Result process(uint8_t* frame, TcFrame& f);
  // Any frame format: `frame` = | primary header (hdr_len octets: TC v1 5, USLP
  // TFPH 7 or 8) | security header | protected data | security trailer |, and
  // `prot_len` counts the octets from the security header to the end of the
  // trailer (FECF already checked and excluded). On SDLS_OK `data`/`data_len`
  // give the plaintext inside `frame`; on any failure nothing is modified.
  Result process(uint8_t* frame, size_t hdr_len, size_t prot_len, uint8_t*& data, size_t& data_len);

  uint32_t last_sn() const { return last_sn_; }
  void set_last_sn(uint32_t sn) { if (sn > last_sn_) last_sn_ = sn; }   // restored by EGSE
  uint32_t auth_failures() const { return fails_; }

 private:
  Result fail(Result r) { ++fails_; return r; }

  uint8_t svc_ = SDLS_SVC_NONE;
  uint8_t key_[32] = {0};        // AUTH: master key
  size_t key_len_ = 0;
  uint16_t spi_ = kSdlsSpiAuth;
  uint32_t last_sn_ = 0;
  uint32_t fails_ = 0;
  AesGcm gcm_;                   // AE: K_tc_ae
};

// ---------------------------------------------------------------------------
// TM sending end (ApplySecurity) for the TM and USLP framers: AE (SPI 3), or
// the null SA (SPI 0) while the integrator has engaged the fallback.
//
// Integration: init() at boot; set_epoch() from the EGSE set_partition RPC;
// poll_epoch_timeout() from the main loop; check ready() BEFORE popping VC0-3
// data into a frame (protect() refusing is only the backstop - the popped
// data would be lost); pass `this` to build_frame() for VC0-3, nullptr for
// OID frames. header_len()/trailer_len() are constant after init(): 14/16 for
// AE (the null SA keeps the same geometry), 0/0 for NONE.
// ---------------------------------------------------------------------------
class SdlsTm : public FrameSecurity {
 public:
  enum State : uint8_t { TM_OFF = 0, TM_PROTECTED = 1, TM_WAIT_EPOCH = 2, TM_UNPROTECTED = 3 };

  // `service` SDLS_SVC_AE with a master key -> AE (K_tm_ae derived here);
  // anything else, or no key -> NONE. Resets epoch, sn and the fallback.
  void init(uint8_t service, const uint8_t* master, size_t master_len);
  // Epoch (SCLK partition) from the EGSE. 0, or lower than the current epoch,
  // is refused (returns false). The same epoch again is a no-op (sn carries
  // on); a higher one restarts sn at 1. Ends the null-SA fallback.
  bool set_epoch(uint16_t epoch);
  // Engages the null-SA fallback when AE is configured, no epoch has arrived
  // and uptime_s >= wait_s (kSdlsEpochWaitS). Returns true exactly once, when
  // it engages (the integrator raises the EVR WARN then).
  bool poll_epoch_timeout(uint32_t uptime_s, uint32_t wait_s);
  void set_fallback(bool on) { fallback_ = on; }

  uint8_t service() const { return ae_ ? SDLS_SVC_AE : SDLS_SVC_NONE; }   // HK sdls_tm_service
  State state() const;                            // HK sdls_tm_state
  uint16_t epoch() const { return epoch_; }       // HK sdls_tm_epoch (0 = none yet)
  uint32_t last_sn() const { return sn_; }        // last sn used under the current epoch
  bool ready() const { return state() != TM_WAIT_EPOCH; }   // VC0-3 frames may be built
  uint32_t frames_protected() const { return n_protected_; }
  uint32_t frames_null() const { return n_null_; }
  uint32_t frames_refused() const { return n_refused_; }

  size_t header_len() const override { return ae_ ? kSdlsAeHdrLen : 0; }
  size_t trailer_len() const override { return ae_ ? kSdlsAeTagLen : 0; }
  bool protect(uint8_t* frame, size_t aad_len, size_t data_len) override;

 private:
  bool ae_ = false;
  bool fallback_ = false;
  uint16_t epoch_ = 0;
  uint32_t sn_ = 0;
  uint32_t n_protected_ = 0, n_null_ = 0, n_refused_ = 0;
  AesGcm gcm_;                   // K_tm_ae
};

}  // namespace ccsds
