// =============================================================================
//  VGQ-1 flight software executive, v3 - implementation (see flight.h).
//
//  Structure of one loop() pass (PB-8.6 item 3; every step bounded, see the WS2
//  loop-timing table): SCLK -> EGSE RPC -> radio events -> spectrometer -> EGSE RPC ->
//  magnetometer / ARU sampling -> deferred MAGBIST -> stored sequence -> CFDP pacing and
//  relay supervision -> SDLS TM epoch timeout -> downlink -> EGSE RPC -> 1 Hz tick ->
//  EGSE notifications -> status display. ("EGSE RPC": one Router Bridge request from the
//  mailbox, rpc_mailbox.h.)
//
//  EVR texts are printf formats with literal event ids (tools/gen_dictionary_doc.py
//  parses `evr(<severity>, 0x....` calls); numbers that the Phase B specification
//  writes as %.1f / %.2f / %.3f are printed from integers (tenths, hundredths,
//  kHz), so no text depends on the C library's floating-point printf.
// =============================================================================
#include "flight.h"
#include "../ccsds/reed_solomon.h"
#include "../ccsds/rice.h"
#if VGQ_RADIO == VGQ_RADIO_SX126X
#include "../drivers/sx126x.h"    // flight_sx126x(): TCXO fall-back diagnostic (EVR 0x0309)
#else
#include "../drivers/e22.h"       // flight_e22(): model strap read at boot (EVR 0x0308)
#endif
#include <Arduino_RouterBridge.h>
#include <math.h>
#include <stdarg.h>
#include <stdio.h>
#include <string.h>
#if __has_include("../sdls_key.h")
#include "../sdls_key.h"          // generated by tools/gen_sdls_key.py (never committed)
#define VGQ_HAVE_SDLS_KEY 1
#endif
#ifndef VGQ_SDLS_SPI
#define VGQ_SDLS_SPI 1            // AUTH SPI when the key header names none (sdls.h kSdlsSpiAuth)
#endif
#if __has_include(<cmsis_core.h>)
#include <cmsis_core.h>
#endif

// Router UART (ArduinoCore-zephyr zephyrSerial.h: the arduino,router-serial node, UNO Q
// LPUART1). Arduino_RouterBridge falls back to Serial1 when a board defines none
// (singletons.cpp); so does this check.
#ifdef ARDUINO_ROUTER_SERIAL
#define VGQ_ROUTER_SERIAL ARDUINO_ROUTER_SERIAL
#else
#define VGQ_ROUTER_SERIAL Serial1
#endif

// Bench-only console log (PB-0.4): Monitor writes can block, so a flight build compiles
// LOGF to nothing while still type-checking its format.
#if VGQ_DEBUG_MONITOR
#define LOGF(level, ...)                                                                    \
  do {                                                                                      \
    char _b[160];                                                                           \
    const int _n = snprintf(_b, sizeof _b, "[%10lu.%03lu] %s ", (unsigned long)(millis() / 1000), \
                            (unsigned long)(millis() % 1000), level);                       \
    if (_n > 0 && (size_t)_n < sizeof _b) (void)snprintf(_b + _n, sizeof _b - _n, __VA_ARGS__); \
    (void)Monitor.println(_b);                                                              \
  } while (0)
#else
#define LOGF(level, ...)                                                                    \
  do {                                                                                      \
    if (0) { (void)snprintf(nullptr, 0, __VA_ARGS__); }                                     \
  } while (0)
#endif

namespace vgq {

using namespace ccsds;

namespace {

// ---- executive constants (each with its reason) ------------------------------------------
const uint8_t  kRadioPollsPerPass = 4;          // radio events handled per pass (radio.h contract)
const size_t   kNotifyMargin = 32;              // MsgPack framing + method name per notification (PB-0.4)
// RPC responses share this UART: update_safe() writes them from __loopHook right after
// loop() returns (bundled patched RouterBridge), the stock library's bridge thread at any
// time (rpc_mailbox.h). One response (MsgPack [1, msgid, nil, result]) is at most ~12
// octets; keep that much free.
const size_t   kRpcResponseReserve = 16;
const size_t   kCaduHexLen = 2 * kCaduLen;      // tm_cadu argument: 472 hex characters
const size_t   kMaxPacketLen = kSpPriHdrLen + kSpSecHdrLen + kMaxPayload;   // 158 octets
// A routine (non-priority) packet may fill a VC buffer only up to here (PB-1.2 reserve).
const size_t   kRoutineVcLimit = VcStream::kBufLen - kVcReserveOctets;      // 768 octets
const uint32_t kBusRecoverMinMs = 10000;        // bus clear at most once per 10 s (PB-8.6 item 9)
const uint8_t  kSpecFaultBusErrors = 3;         // AS7265X FAULT escalates with >= 3 bus errors
const uint8_t  kI2cFdirErrors = 10;             // FDIR I2C_BUS: more consecutive errors than this
const uint32_t kScanSettleMs = 60;              // receiver settling on a survey channel (v2)
const uint32_t kScanReplyGuardMs = 1000;        // a survey step never waits longer for NOISE
const uint8_t  kBurstPacketsPerPass = 2;        // SPECBURST packets built per pass (Rice time bound)
const uint16_t kVcCongestSetOctets = 640;       // FDIR VC_CONGEST set (routine fill limit 768, PB-8.6 item 7)
const uint16_t kVcCongestClearOctets = 300;
const size_t   kDiagEvrOctets = 95;             // one SPECDIAG EVR packet: 12 + 3 + 80
const size_t   kDiagBacklogMax = 512;           // SPECDIAG lines only while VC0 holds <= 512 - 95
const uint32_t kNoBitLockMs = 300000;           // CLCW No Bit Lock: no CLTU decoded for 5 min (v2)
const uint32_t kLoopOverrunMs = 250;            // HK loop_overruns threshold
const uint32_t kRebootDrainMs = 50;             // lets the last tm_cadu copy leave the UART
const uint32_t kRebootMaxWaitMs = 10000;        // REBOOT without 2 frames sent: reset after >= 10 s
const uint8_t  kBeaconMaxFrames = 2;            // hibernation beacon: VC0 backlog + HK in <= 2 frames
const uint32_t kPaKeyedSpecBudgetUs = 2000;     // AS7265X poll budget while the PA is keyed
const uint32_t kNoiseAfterTxMs = 300;           // noise sample not right after a transmission (v2)
const uint32_t kT37sFaultClearMs = 3000;        // T37S reports repeat every 500 ms while active
const uint32_t kRxFlashMs = 500;                // status display RX row

const char* const kSevName[5] = {"DIAG", "INFO", "WARN", "ERROR", "FATAL"};

inline uint16_t sat16(uint32_t v) { return v > 65535u ? (uint16_t)65535u : (uint16_t)v; }
inline uint32_t umin32(uint32_t a, uint32_t b) { return a < b ? a : b; }
inline void inc16(uint16_t& c) { if (c < 65535u) ++c; }

// u32 -> int32 two's complement without implementation-defined conversion (the EGSE
// stores the value as received and never interprets it, PB-4.1 sdls_sn).
inline int32_t as_i32(uint32_t v) {
  return v <= 0x7FFFFFFFu ? (int32_t)v : (int32_t)(v - 0x80000000u) - (int32_t)0x7FFFFFFF - 1;
}

inline int16_t clamp_i16(float v) {
  if (isnan(v)) return kNaI16;
  if (v > 32766.0f) return 32766;
  if (v < -32767.0f) return -32767;
  return (int16_t)lroundf(v);
}
inline int32_t clamp_i32(float v) {
  if (isnan(v)) return kNaI32;
  if (v > 2.0e9f) return 2000000000;
  if (v < -2.0e9f) return -2000000000;
  return (int32_t)lroundf(v);
}
inline uint16_t clamp_u16(float v) {        // 0..65534 (0xFFFF is the sentinel)
  if (isnan(v)) return kNaU16;
  if (v <= 0.0f) return 0;
  if (v >= 65534.0f) return 65534;
  return (uint16_t)lroundf(v);
}

// Upper-case hex of n octets. reserve() first: one transient allocation (PB-0.4).
String to_hex(const uint8_t* d, size_t n) {
  static const char kHex[] = "0123456789ABCDEF";
  String s;
  (void)s.reserve(2 * n);
  for (size_t i = 0; i < n; ++i) {
    s += kHex[d[i] >> 4];
    s += kHex[d[i] & 15];
  }
  return s;
}

// A notification String from n characters of a C string, reserved first.
String text_string(const char* t, size_t n) {
  String s;
  (void)s.reserve(n);
  s += t;
  return s;
}

int hexval(char c) {
  if (c >= '0' && c <= '9') return c - '0';
  if (c >= 'a' && c <= 'f') return c - 'a' + 10;
  if (c >= 'A' && c <= 'F') return c - 'A' + 10;
  return -1;
}

// Decodes an RPC hex argument: even length within [min_chars, max_chars] and fitting
// `cap` octets, hex digits only. Returns the octet count, 0 for anything else.
size_t hex_decode(const char* p, size_t len, uint8_t* out, size_t cap, size_t min_chars, size_t max_chars) {
  if (len < min_chars || len > max_chars || (len & 1u) != 0 || len / 2 > cap) return 0;
  if (p == nullptr) return 0;
  for (size_t i = 0; i < len / 2; ++i) {
    const int hi = hexval(p[2 * i]), lo = hexval(p[2 * i + 1]);
    if (hi < 0 || lo < 0) return 0;
    out[i] = (uint8_t)((hi << 4) | lo);
  }
  return len / 2;
}

const char* reset_cause_name(uint8_t c) {
  switch (c) {
    case 0: return "POWER-ON";
    case 1: return "PIN";
    case 2: return "SOFTWARE";
    case 3: return "WATCHDOG";
    case 4: return "BROWNOUT";
    default: return "UNKNOWN";
  }
}

const char* sdls_service_name(uint8_t s) {
  return s == SDLS_SVC_AE ? "AE" : s == SDLS_SVC_AUTH ? "AUTH" : "NONE";
}

// HK radio_fault meanings (ground dictionary RADIO_FAULTS).
const char* radio_fault_name(uint8_t code) {
  switch (code) {
    case kRadioFaultUnderVoltage: return "UNDER-VOLTAGE (<4.5 V)";
    case kRadioFaultOverVoltage: return "OVER-VOLTAGE (>15 V)";
    case kRadioFaultOverTemp: return "OVER-TEMPERATURE (>120 C)";
    case kRadioFaultOvAndOt: return "OVER-VOLTAGE + OVER-TEMPERATURE";
    case kRadioFaultBusyStuck: return "BUSY stuck";
    case kRadioFaultSpi: return "SPI/command error";
    case kRadioFaultReinit: return "re-init failed";
    case kRadioFaultNoIrq: return "no IRQ";
    default: return "none";
  }
}

// SPEC v3.1 class_id names (ground spectral.py classes).
const char* spec_class_name(uint8_t c) {
  static const char* const kName[8] = {"UNKNOWN", "DARK", "DAYLIGHT", "INCANDESCENT",
                                       "WHITE LED", "FLUORESCENT", "NARROWBAND", "OWN LAMP"};
  return c < 8 ? kName[c] : "?";
}

// AS7265X devices present (dev_mask b0 AS72651 NIR, b1 AS72652 VIS, b2 AS72653 UV).
const char* spec_device_names(uint8_t mask) {
  static const char* const kName[8] = {"none", "NIR", "VIS", "NIR+VIS", "UV", "NIR+UV", "VIS+UV",
                                       "NIR+VIS+UV"};
  return kName[mask & 7u];
}

// Signed tenths as "<sign><whole>.<tenth>" pieces for "%s%u.%u".
struct Tenths {
  const char* sign;
  unsigned whole;
  unsigned tenth;
};
Tenths tenths(int32_t v) {
  Tenths t;
  t.sign = v < 0 ? "-" : "";
  const uint32_t a = v < 0 ? (uint32_t)(-(v + 1)) + 1u : (uint32_t)v;
  t.whole = (unsigned)(a / 10u);
  t.tenth = (unsigned)(a % 10u);
  return t;
}

// Nicla Sense ME health bits from the ARU page flags (motion b0..b3, environment b0..b1).
const uint16_t kMeBits = SNS_ME_QUAT | SNS_ME_ACC | SNS_ME_GYRO | SNS_ME_MAG | SNS_ME_BARO | SNS_ME_BSEC;
// `bit` when `on`, else 0 (keeps enumerators and plain integers out of one ?: expression).
inline unsigned bit_if(bool on, unsigned bit) { return on ? bit : 0u; }

uint16_t me_bits(uint8_t mf, uint8_t ef) {
  return (uint16_t)(bit_if(mf & 1u, SNS_ME_QUAT) | bit_if(mf & 2u, SNS_ME_ACC) |
                    bit_if(mf & 4u, SNS_ME_GYRO) | bit_if(mf & 8u, SNS_ME_MAG) |
                    bit_if(ef & 1u, SNS_ME_BARO) | bit_if(ef & 2u, SNS_ME_BSEC));
}

MagVector mag_vec(const MagStats& s, bool ok) {
  MagVector v{kNaI32, kNaI32, kNaI32, kNaU16};
  if (!ok || !s.count()) return v;
  float x, y, z;
  s.mean(x, y, z);
  v.bx_nT = clamp_i32(x * 1000.0f);
  v.by_nT = clamp_i32(y * 1000.0f);
  v.bz_nT = clamp_i32(z * 1000.0f);
  v.rms_nT = clamp_u16(s.rms_fluct() * 1000.0f);
  return v;
}

uint16_t permille_of_vc(size_t backlog) { return (uint16_t)(backlog * 1000u / VcStream::kBufLen); }

}  // namespace

// =============================================================================
// Setup (PB-8.6 item 2)
// =============================================================================
SpecTuning Flight::spec_tuning() {
  SpecTuning t;
  t.baseline_alpha = kSpecBaselineAlpha;
  t.event_cdeg = kSpecEventCdeg;
  return t;
}

SpecConfig Flight::spec_default_config() {
  SpecConfig c;
  c.gain = kSpecDefaultGain;
  c.int_cycles = kSpecDefaultCycles;
  c.burst_cycles = kSpecBurstCycles;
  return c;
}

void Flight::setup(const char* bridge_failures) {
  in_setup_ = true;
  display_.begin();
  reset_cause_ = read_reset_cause();
  ReedSolomon::init();
  const size_t ssr_bytes = ssr_.begin(kSsrMaxBytes, kSsrMinBytes, kHeapReserveBytes);
  LOGF("INFO", "SSR %u KiB allocated", (unsigned)(ssr_bytes / 1024u));

  // SDLS: both services need the generated master key; without it both run NONE
  // (contract 5) and HK sdls_tc_service / sdls_tm_service say so.
#ifdef VGQ_HAVE_SDLS_KEY
  sdls_tc_.configure(VGQ_SDLS_TC, kVgqSdlsKey, sizeof kVgqSdlsKey, VGQ_SDLS_SPI);
  sdls_tm_.init(VGQ_SDLS_TM, kVgqSdlsKey, sizeof kVgqSdlsKey);
  // The TC anti-replay counter is RAM only: until the EGSE restores it (set_sdls_sn)
  // a recorded authentic frame would pass the replay check (C17).
  sdls_tc_.hold_for_restore();
#else
  sdls_tc_.configure(SDLS_SVC_NONE, nullptr, 0);
  sdls_tm_.init(SDLS_SVC_NONE, nullptr, 0);
#endif
  char idle[kIdleTextMax + 1];
  (void)format_idle_text(VGQ_CALLSIGN, idle, sizeof idle);   // "DE <callsign> VGQ-1 "
  dl_.init(VGQ_DOWNLINK_FRAMING == 1 ? FRAMING_USLP : FRAMING_TM,
           sdls_tm_.service() == SDLS_SVC_AE ? &sdls_tm_ : nullptr, idle);

  // Autonomy (contract 24, 29): RAM-only tables, the live-command validator, and the
  // beacon monitor before the first EVR (it must see every EVR).
  seq_.reset();
  seq_.set_validator(validate_stored_command, nullptr);
  magcal_.reset();
  beacon_.begin(reset_cause_);

  init_radio();
  init_sensors();

  note_valid_tc(millis());              // command-loss timer and HK cmd_loss_timer_s start at boot
  set_mode(MODE_SAFE, "boot");          // like a real spacecraft: come up safe, wait for the ground
  safe_by_fdir_ = true;
  evr(1, 0x0001, "BOOT VGQ-1 FSW 3.0 rst=%u %s radio=%s %s TC %s TM %s", (unsigned)reset_cause_,
      reset_cause_name(reset_cause_), radio_.name(), VGQ_DOWNLINK_FRAMING == 1 ? "USLP" : "TM",
      sdls_service_name(sdls_tc_.service()), sdls_service_name(sdls_tm_.service()));
  evr(1, 0x0003, "SSR capacity %lu KiB", (unsigned long)(ssr_.capacity() / 1024u));
  evr(1, 0x0004, "stored sequence table and MAGCAL are RAM only: empty after boot");
  evr(1, 0x0002, "DE %s", VGQ_CALLSIGN);  // station identification
  if (bridge_failures != nullptr && bridge_failures[0] != '\0')
    evr(2, 0x0005, "Bridge registration failed: %s", bridge_failures);

  // The EGSE answers sc_boot with a NEW SCLK partition = SDLS TM epoch (PB-6.3).
  boot_note_pending_ = true;
  flush_notifications(millis());

  const uint32_t now = millis();
  last_1hz_ms_ = last_refill_ms_ = last_disp_ms_ = now;
  last_callsign_s_ = sclk_.seconds();
  in_setup_ = false;
  evr_gate_.fill();                     // the routine-EVR budget starts full (PB-2.6)
  watchdog_start();                     // last: setup()'s long waits are behind us
}

// Independent hardware watchdog (config.h VGQ_IWDG, RM0456 IWDG). Register sequence of
// RM0456 / ST HAL_IWDG_Init (and Zephyr wdt_iwdg_stm32): start (KR = CCCC, LSI forced
// on), unlock (5555), prescaler, reload, wait until IWDG_SR shows both written to the LSI
// domain (bounded: until then the reset value /4 x 4096 = 512 ms applies), refresh. The
// Zephyr watchdog API cannot be used: the platform is built without CONFIG_WATCHDOG.
void Flight::watchdog_start() {
#if VGQ_IWDG && defined(IWDG) && defined(IWDG_SR_PVU) && defined(IWDG_SR_RVU)
  IwdgSettings w;
  if (!iwdg_settings(kIwdgTimeoutMs, kIwdgLsiHz, w)) return;   // constant: never fails (host-tested)
#ifdef DBGMCU_APB1FZR1_DBG_IWDG_STOP
  DBGMCU->APB1FZR1 |= DBGMCU_APB1FZR1_DBG_IWDG_STOP;          // paused while a debugger halts the core
#endif
  IWDG->KR = 0x0000CCCCu;                                      // start
  IWDG->KR = 0x00005555u;                                      // PR / RLR write access
  IWDG->PR = w.pr;
  IWDG->RLR = w.rlr;
  const uint32_t t0 = millis();
  bool ready = false;
  while (!ready && millis() - t0 <= kIwdgUpdateWaitMs)         // bounded (setup only)
    ready = (IWDG->SR & (IWDG_SR_PVU | IWDG_SR_RVU)) == 0u;
  IWDG->KR = 0x0000AAAAu;                                      // refresh with the new reload
  watchdog_armed_ = true;
  if (!ready)
    evr(3, 0x060C, "IWDG settings not confirmed in %lu ms: watchdog runs, timeout may be short",
        (unsigned long)kIwdgUpdateWaitMs);
#endif
}

void Flight::watchdog_feed() {
#if VGQ_IWDG && defined(IWDG)
  if (watchdog_armed_ && rpc_.on_loop_thread()) IWDG->KR = 0x0000AAAAu;
#endif
}

// Reset cause (HK reset_cause, contract 15). RCC_CSR alone cannot separate a power-up
// from a brown-out on the STM32U5 (classify_reset_cause()); the discriminator is a magic
// word in TAMP backup register 31 (backup domain: kept through a reset while VDD stays
// above the backup-domain POR, cleared by a power-up). Written on every boot, so a
// brown-out during setup() is recognised too. Backup-domain write access (PWR_DBPR DBP)
// is restored to its previous state afterwards (Zephyr CONFIG_STM32_BACKUP_PROTECTION).
uint8_t Flight::read_reset_cause() {
#if defined(RCC) && defined(RCC_CSR_SFTRSTF) && defined(RCC_CSR_RMVF)
  const uint32_t csr = RCC->CSR;
  uint8_t flags = 0;
  if (csr & RCC_CSR_IWDGRSTF) flags |= RST_F_IWDG;
#ifdef RCC_CSR_WWDGRSTF
  if (csr & RCC_CSR_WWDGRSTF) flags |= RST_F_WWDG;
#endif
  if (csr & RCC_CSR_SFTRSTF) flags |= RST_F_SOFT;
  if (csr & RCC_CSR_BORRSTF) flags |= RST_F_BOR;
  if (csr & RCC_CSR_PINRSTF) flags |= RST_F_PIN;
  RCC->CSR |= RCC_CSR_RMVF;            // clear the flags for the next boot
  bool warm = false;
#if defined(TAMP) && defined(PWR_DBPR_DBP) && defined(RCC_APB3ENR_RTCAPBEN)
  static const uint32_t kWarmMagic = 0x56475131u;   // "VGQ1"
#ifdef RCC_AHB3ENR_PWREN
  RCC->AHB3ENR |= RCC_AHB3ENR_PWREN;                // PWR_DBPR access
#endif
  RCC->APB3ENR |= RCC_APB3ENR_RTCAPBEN;             // TAMP registers are on the RTC APB clock
  (void)RCC->APB3ENR;                               // read back: clock on before the access
  warm = TAMP->BKP31R == kWarmMagic;
  const uint32_t dbp = PWR->DBPR & PWR_DBPR_DBP;
  PWR->DBPR |= PWR_DBPR_DBP;
  TAMP->BKP31R = kWarmMagic;
  if (!dbp) PWR->DBPR &= ~PWR_DBPR_DBP;
#endif
  return classify_reset_cause(flags, warm);
#else
  return 255;                          // not accessible from this build: UNKNOWN
#endif
}

void Flight::init_radio() {
  const bool up = radio_.begin();
  report_radio_model();
  report_tcxo();
  rcfg_ = RadioSettings();
  rcfg_.channel = kRadioChannel;
  rcfg_.rate_code = kRadioRateCode;
  rcfg_.lbt = kRadioLbt;
  rcfg_.rx_boost = kRadioRxBoost;
  rcfg_.address = kE22Address;
  rcfg_.netid = kE22NetId;
  // Brown-out derating (contract 15): a marginal supply is not hit by full-power peaks again.
  rcfg_.power_code = radio_boot_power_code(reset_cause_ == kResetCauseBrownout, kRadioPowerCode,
                                           kBrownoutPowerCode);
  if (rcfg_.power_code != kRadioPowerCode)
    evr(2, 0x0608, "brownout reset: TX power derated (code %u) - check radio supply",
        (unsigned)rcfg_.power_code);
  // Volatile write (E22 C2): the configuration is re-asserted from flight constants at
  // every boot instead of wearing the module's flash.
  radio_cfg_ok_ = up && radio_.configure(rcfg_, false);
  if (!radio_cfg_ok_) fdir_flags_ |= FDIR_RADIO_CFG;
  report_radio(true);
}

void Flight::report_radio(bool boot) {
  SensSource src = SensSource::COMPUTED;
  const int16_t sens = radio_sensitivity_ddbm(radio_.model(), rcfg_.rate_code, radio_.rx_boost_active(), &src);
  const Tenths s = tenths(sens);
  const int pwr = radio_tx_power_dbm(radio_.model(), rcfg_.power_code, kSxPaGainDb);
  if (radio_cfg_ok_) {
    evr(1, 0x0306, "radio %s %s: ch %u code %u pwr %d dBm sens %s%u.%u dBm %s", radio_.name(), "OK",
        (unsigned)rcfg_.channel, (unsigned)rcfg_.rate_code, pwr, s.sign, s.whole, s.tenth,
        sens_source_name(src));
  } else {
    evr(3, 0x0306, "radio %s %s: ch %u code %u pwr %d dBm sens %s%u.%u dBm %s", radio_.name(), "FAILED",
        (unsigned)rcfg_.channel, (unsigned)rcfg_.rate_code, pwr, s.sign, s.whole, s.tenth,
        sens_source_name(src));
  }
  LOGF("INFO", "radio configuration %s (%s)", radio_cfg_ok_ ? "verified" : "FAILED", boot ? "boot" : "change");
}

// Contract 33: the E22 model in use and how the boot strap selected it (the RF packet
// radio_model carries the same model). A split reading (some reads LOW, some HIGH: a
// loose jumper or a long lead picking up noise) is decided by majority and reported
// as a WARN so the wiring gets checked.
void Flight::report_radio_model() {
#if VGQ_RADIO != VGQ_RADIO_SX126X
  const E22Radio& e = flight_e22();
  if (!e.strap_fitted()) {
    evr(1, 0x0308, "radio model %s (no strap; build %s)", radio_model_name(e.model()),
        radio_model_name(e.build_model()));
    return;
  }
  const unsigned low = e.strap_low_reads(), n = kStrapSamples;
  const char* level = low == 0 ? "open" : low == n ? "to GND" : "SPLIT";
  if (low == 0 || low == n) {
    evr(1, 0x0308, "radio model %s (strap %s, %u/%u low; build %s)", radio_model_name(e.model()), level, low, n,
        radio_model_name(e.build_model()));
  } else {
    evr(2, 0x0308, "radio model %s (strap %s, %u/%u low; build %s)", radio_model_name(e.model()), level, low, n,
        radio_model_name(e.build_model()));
  }
#endif
}

// SX126x (audit DS-09): RadioLib falls back to the crystal silently when the TCXO does
// not start (DS 13.3.6, XOSC_START_ERR); the driver detects it and keeps config_ok()
// false. Reported after begin() and after every recovery (each re-runs begin()).
void Flight::report_tcxo() {
#if VGQ_RADIO == VGQ_RADIO_SX126X
  if (flight_sx126x().tcxo_fallback())
    evr(2, 0x0309, "SX126x TCXO did not start: running on the crystal (VERIFY kSxTcxoV)");
#endif
}

void Flight::init_sensors() {
  // Bus clear first (AS-T6): a target left mid-transfer by the previous run cannot hold SDA.
  bus_.begin(SENSOR_WIRE, kI2cClockHz, kPinSensorSda, kPinSensorScl);
  bus_clear_failed_ = !bus_.begin_clear_ok();   // retried by reprobe_instruments()
  if (bus_clear_failed_)
    evr(3, 0x060A, "I2C bus clear: SDA or SCL still low after %u clocks", (unsigned)kI2cClearMaxPulses);
  // The Qwiic connector: no bus clear (PD12/PD13 are not Arduino pin numbers).
  qwiic_.begin(QWIIC_WIRE, kI2cClockHz);
  reprobe_.begin(millis());
  uint16_t h = 0;
  if (aru_.begin(bus_)) {
    h |= SNS_NICLA_ME;
    if (aru_.read_motion(aru_last_)) aru_valid_ = true;
  }
  // Bounded boot identification (<= ~2 s, as7265x.h begin()); lamps off afterwards.
  const bool spec_ok = spec_.begin(bus_, kPinSpecInt, &qwiic_);   // A4/A5 first, then Qwiic
  if (spec_ok) h |= SNS_AS7265X;
  if (mag_ob_.begin(bus_, kRm3100ObAddr)) h |= SNS_RM3100_OB;
  if (mag_ib_.begin(bus_, kRm3100IbAddr)) h |= SNS_RM3100_IB;     // optional second unit
  sensor_health_ = h;
  run_boot_bist();
  if (spec_ok) {
    spec_reported_ = SPEC_REP_OK;
    report_spec_identity();
  } else if (spec_.state() == As7265x::ST_ABSENT) {
    spec_reported_ = SPEC_REP_ABSENT;
    evr(2, 0x0707, "AS7265X %s", "ABSENT");
  } else {
    spec_reported_ = SPEC_REP_FAULT;
    evr(2, 0x0707, "AS7265X %s", "FAULT");
  }
}

void Flight::report_spec_identity() {
  const As7265x::Info& i = spec_.info();
  evr(1, 0x0706, "AS7265X HW %02X/%02X FW %u.%u.%u devices %s on %s", (unsigned)i.hw_type,
      (unsigned)i.hw_version, (unsigned)i.fw_major, (unsigned)i.fw_patch, (unsigned)i.fw_build,
      spec_device_names(i.dev_mask), spec_.on_alt_bus() ? "Qwiic" : "A4/A5");
}

// RM3100 self-test of the fitted units at boot (contract 24.5), never while an AS7265X
// lamp may be lit: then it runs from the loop in the next lamps-off, PA-off window.
void Flight::run_boot_bist() {
  // A unit that is not fitted reports NOT RUN at once (no bus access); a fitted one waits
  // for the lamps when the AS7265X may have one lit (boot after a reset mid-exposure).
  const bool lamps = spec_.lamps_lit();
  for (uint8_t unit = 0; unit < kMagUnits; ++unit) {
    const bool fitted = unit ? mag_ib_.ok() : mag_ob_.ok();
    if (fitted && lamps) bist_pending_ = (uint8_t)(bist_pending_ | (1u << unit));
    else run_bist_unit(unit);
  }
  bist_wait_t0_ = millis();
}

void Flight::run_bist_unit(uint8_t unit) {
  Rm3100& m = unit ? mag_ib_ : mag_ob_;
  const MagBistResult r = m.ok() ? m.run_bist() : mag_bist_not_run();
  if (r.status != MAG_BIST_BUSY) {        // BUSY keeps the previous result (autonomy.h)
    if (unit) bist_ib_ = r;
    else bist_ob_ = r;
  }
  char t[kEvrTextMax + 1];
  (void)mag_bist_evr_text(unit, r, t, sizeof t);
  const bool warn = mag_bist_evr_severity(r) >= kEvrSevWarn;
  if (unit == 0) {
    if (warn) evr(2, 0x0910, "%s", t);
    else evr(1, 0x0910, "%s", t);
  } else {
    if (warn) evr(2, 0x0911, "%s", t);
    else evr(1, 0x0911, "%s", t);
  }
}

// =============================================================================
// Main loop (PB-8.6 item 3)
// =============================================================================
void Flight::loop() {
  const uint32_t now = millis();
  loop_start_ms_ = now;
  (void)sclk_.now_us();                 // keeps the 64-bit SCLK current (micros() wraps every 71 min)
  large_sent_ = false;
  evr_notes_pass_ = 0;

  // EGSE RPCs (rpc_mailbox.h): with the bundled patched RouterBridge every handler runs
  // in __loopHook on this thread and the mailbox stays empty. A handler waiting on another
  // thread (the stock library's bridge thread) is served here, at the top and between the
  // phases that can be long, so it is answered within one phase, not one whole pass.
  service_rpc();
  service_radio(now);
  service_spec(now);
  service_rpc();
  service_mag(now);
  service_bist(now);

  // Stored command sequence: at most one entry per pass (contract 24.2).
  SeqEvent ev;
  switch (seq_.poll(sclk_.seconds(), safe_by_fdir_, ev)) {
    case SEQ_EV_EXECUTE:
      evr(1, 0x0904, "SEQ slot %u: opcode 0x%02X", (unsigned)ev.slot, (unsigned)ev.cmd[0]);
      execute_user(ev.cmd, ev.len <= kSeqCmdMax ? ev.len : kSeqCmdMax, 0, CMD_SRC_STORED);
      if (ev.completed) evr(1, 0x0906, "sequence COMPLETE");
      break;
    case SEQ_EV_SKIPPED_LATE:
      evr(2, 0x0905, "SEQ slot %u skipped: %lu s late", (unsigned)ev.slot, (unsigned long)ev.late_s);
      if (ev.completed) evr(1, 0x0906, "sequence COMPLETE");
      break;
    case SEQ_EV_STOPPED_BY_FDIR:
      evr(2, 0x0907, "sequence STOPPED by fault protection");
      break;
    case SEQ_EV_NONE:
    default:
      break;
  }

  service_cfdp(now);
  if (sdls_tm_.poll_epoch_timeout(sclk_.seconds(), kSdlsEpochWaitS))
    evr(2, 0x0121, "SDLS TM: no epoch after %lu s: null SA (clear) until the EGSE sends one",
        (unsigned long)kSdlsEpochWaitS);
  // Bounded wait for the TC anti-replay restore: without an EGSE the spacecraft must
  // stay commandable, so the hold ends (from the in-RAM counter) and says so.
  if (sdls_tc_.held() && sclk_.seconds() >= kSdlsSnWaitS) {
    sdls_tc_.release_hold();
    evr(2, 0x0124, "SDLS TC: no anti-replay restore after %lu s: accepting above sn %lu",
        (unsigned long)kSdlsSnWaitS, (unsigned long)sdls_tc_.last_sn());
  }
  service_tx(now);                      // may run an E22 configure() (typically 60-80 ms)
  service_rpc();

  if (now - last_1hz_ms_ >= 1000u) {
    last_1hz_ms_ = (now - last_1hz_ms_ > 3000u) ? now : last_1hz_ms_ + 1000u;   // no burst catch-up
    tick_1hz(now);
  }
  flush_notifications(now);
  if (now - last_disp_ms_ >= 250u) {
    last_disp_ms_ = now;
    update_display(now);
  }
  const uint32_t dt = millis() - loop_start_ms_;
  if (dt > loop_max_ms_) loop_max_ms_ = sat16(dt);
  if (dt > kLoopOverrunMs) inc16(loop_overruns_);
}

// =============================================================================
// Radio events (PB-8.6 item 3; radio report recipe)
// =============================================================================
void Flight::service_radio(uint32_t now) {
  for (uint8_t i = 0; i < kRadioPollsPerPass; ++i) {
    int32_t value = 0;
    rx_pkt_.crc_ok = true;              // a driver that delivers CRC failures clears it per packet
    const RadioEvent e = radio_.poll(now, rx_pkt_, value);
    switch (e) {
      case RadioEvent::NONE: return;
      case RadioEvent::PACKET: on_uplink_packet(now); break;
      case RadioEvent::NOISE: on_noise(now, value); break;
      case RadioEvent::TX_DONE: on_tx_end(value, false); break;
      case RadioEvent::TX_TIMEOUT: on_tx_end(value, true); break;
      case RadioEvent::FAULT: on_radio_fault(now, value); break;
    }
  }
}

void Flight::on_uplink_packet(uint32_t now) {
  last_rx_flash_ms_ = now;
  uplink_rssi_ = rx_pkt_.rssi_dbm;
  uplink_snr_cdb_ = rx_pkt_.snr_cdb;
  uplink_ferr_hz_ = rx_pkt_.freq_err_hz;
  const size_t n = rx_pkt_.len <= RxPacket::kMaxLen ? rx_pkt_.len : RxPacket::kMaxLen;
  // F-38: a payload with a LoRa CRC error still reaches the CLTU decoder; BCH, FECF and
  // SDLS decide alone whether it is accepted.
  process_tc(rx_pkt_.data, n, false, rx_pkt_.crc_ok);
}

void Flight::on_noise(uint32_t now, int32_t dbm) {
  if (scan_state_ == SCAN_WAIT_REPLY) {
    scan_store(dbm, now);
    return;
  }
  if (dbm == kRadioNaI32) return;       // no answer: keep the last reading
  noise_dbm_ = dbm < -32767 ? (int16_t)-32767 : dbm > 32766 ? (int16_t)32766 : (int16_t)dbm;
}

void Flight::on_tx_end(int32_t elapsed_ms, bool timeout) {
  if (tx_state_ != TX_WAIT_DONE) return;           // not ours (cannot happen: one event per transmit)
  const uint32_t busy = elapsed_ms > 0 ? (uint32_t)elapsed_ms : 0u;
  if (timeout) {
    inc16(aux_timeouts_);
    fdir_flags_ |= FDIR_AUX_TIMEOUT;
    evr(3, 0x0301, "radio TX timeout (%lu ms) - TX path suspect", (unsigned long)busy);
  } else {
    fdir_flags_ &= (uint16_t)~FDIR_AUX_TIMEOUT;    // F-25: cleared by the next good transmission
  }
  last_airtime_ms_ = busy;
  airtime_total_ms_ += busy;
  duty_.on_tx(tx_start_ms_, busy);
  if (!timeout) {
    // TIMECORR reference (PB-1.7): SCLK when the PA was keyed. With SX126x CAD/LBT the
    // radio keys later than transmit(): last_tx_launch_ms() says when.
    const uint32_t launch = radio_.last_tx_launch_ms();
    const uint32_t late = launch - tx_start_ms_;
    if (late < 60000u) tx_start_sclk_us_ += (uint64_t)late * 1000u;
    // TM: any frame; USLP: only VC0 frames carry a usable count (§6).
    const bool usable = dl_.framing() == FRAMING_TM || (!tx_frame_.oid && tx_frame_.vcid == VC_RT_ENG);
    if (usable) {
      tc_ref_valid_ = true;
      tc_ref_count_ = tx_frame_.count;
      tc_ref_sclk_us_ = tx_start_sclk_us_;
      tc_ref_airtime_ms_ = busy;
      tc_ref_rate_ = rcfg_.rate_code;
      if (timecorr_request_) {
        timecorr_request_ = false;
        gen_timecorr();
      }
    }
  }
  tx_state_ = TX_IDLE;
  if (cfg_change_after_frames_ && --cfg_change_after_frames_ == 0) radio_reconfig_pending_ = true;
  if (reboot_pending_ && reboot_after_frames_ && --reboot_after_frames_ == 0) do_reboot("after 2 frames");
}

void Flight::do_reboot(const char* why) {
  LOGF("WARN", "commanded reboot (%s)", why);
  (void)why;
  delay(kRebootDrainMs);                // the last tm_cadu copy leaves the UART (~43 ms)
#if defined(__ARM_ARCH)
  NVIC_SystemReset();
#endif
}

void Flight::on_radio_fault(uint32_t now, int32_t code) {
  if (code >= kRadioFaultUnderVoltage && code <= kRadioFaultOvAndOt) {
    // E22-400T37S abnormal status (FF FF FF 0x, repeated every 500 ms while active).
    const uint8_t fc = (uint8_t)code;
    inc16(radio_fault_reports_);
    radio_fault_ms_ = now;
    if (fc == radio_fault_code_) return;
    radio_fault_code_ = fc;
    fdir_flags_ |= FDIR_RADIO_FAULT;
    evr(3, 0x0310 + fc, "E22 reports %s - module RF output disabled", radio_fault_name(fc));
    if (fc == kRadioFaultUnderVoltage) fdir_flags_ |= FDIR_LOW_BUS_V;
    if (fc >= kRadioFaultOverTemp) {
      fdir_flags_ |= FDIR_PA_OVERTEMP;
      // The T37S cannot lower its output power: the thermal lever is duty cycle.
      // Silence the PA for a cool-down, then resume at SAFE cadence (frame period
      // doubled while PA_OVERTEMP stays set, frame_period_ms()).
      // A commanded TXINHIBIT in force does not skip the response (C21): the cool-down
      // extends it (never shortens a longer one), and SAFE follows as for any episode.
      if (fdir_mask_ & FDIR_PA_OVERTEMP) {
        const uint32_t until = now + (uint32_t)kPaCooldownS * 1000u;
        if (!tx_inhibit_ || (int32_t)(until - tx_inhibit_until_ms_) > 0) tx_inhibit_until_ms_ = until;
        tx_inhibit_ = true;
        fdir_flags_ |= FDIR_TX_INHIBIT;
        evr(4, 0x0604, "PA over-temperature: transmitter OFF for %u s, SAFE", (unsigned)kPaCooldownS);
        enter_fdir_safe("PA over-temperature");
      }
    }
    return;
  }
  if (code == kRadioFaultCleared) {
    // SX126x recovered: reset, re-initialised, settings re-applied by the driver.
    radio_cfg_ok_ = radio_.config_ok();
    if (radio_cfg_ok_) fdir_flags_ &= (uint16_t)~FDIR_RADIO_CFG;
    if (radio_fault_code_ >= kRadioFaultBusyStuck) radio_fault_code_ = 0;
    evr(1, 0x0305, "radio recovered (%u recoveries)", (unsigned)radio_.recoveries());
    report_tcxo();
    return;
  }
  if (code >= kRadioFaultBusyStuck && code <= kRadioFaultNoIrq) {
    const uint8_t fc = (uint8_t)code;
    radio_fault_code_ = fc;
    inc16(radio_fault_reports_);
    radio_cfg_ok_ = false;
    fdir_flags_ |= FDIR_RADIO_CFG;
    evr(3, 0x0304, "radio fault %u (%s) - recovering", (unsigned)fc, radio_fault_name(fc));
  }
  // Any other value is not a defined RadioFault: ignored (range check of driver input).
}

// =============================================================================
// Uplink: CLTU -> frame -> SDLS -> TFDF -> FARM-1 -> dispatch (PB-8.6 item 4)
// =============================================================================
void Flight::process_tc(const uint8_t* in, size_t n, bool hardline, bool crc_ok) {
  uint8_t work[kTcWorkMin];
  const TcOutcome o = tc_accept(in, n, work, sizeof work, bch_, sdls_tc_, farm_);
  if (o.stage == TcStage::NO_CLTU) {
    ++cltu_bad_;
    LOGF("WARN", "%s packet (%u octets) without a decodable CLTU", hardline ? "hardline" : "RF", (unsigned)n);
    return;
  }
  ++cltu_ok_;
  last_cltu_ms_ = millis();
  no_bit_lock_ = false;
  if (o.stage == TcStage::FRAME_REJECTED) {
    ++tc_bad_;
    const uint8_t pr = o.parse;
    evr(2, 0x0100 + pr, "TC frame rejected: %s", tc_parse_result_name(o.parse));
    return;
  }
  if (o.stage == TcStage::SDLS_REJECTED && o.sdls == Sdls::SDLS_NOT_RESTORED) {
    ++tc_bad_;                                     // authentic: not a security fault (no FDIR)
    evr(2, 0x0123, "SDLS TC refused: anti-replay counter not restored by the EGSE yet");
    return;
  }
  if (o.stage == TcStage::SDLS_REJECTED) {
    ++tc_bad_;
    fdir_flags_ |= FDIR_SDLS_AUTH;
    const uint8_t sr = o.sdls;
    evr(3, 0x0110 + sr, "SDLS rejected TC frame: %s", Sdls::result_name(o.sdls));
    return;
  }
  // From here the frame passed SDLS (or SDLS is off): an accepted frame consumed its SN,
  // which the EGSE persists (sdls_sn).
  if (sdls_tc_.enabled()) sdls_sn_pending_ = true;
  if (o.stage == TcStage::TFDF_REJECTED) {
    ++tc_bad_;
    const uint8_t pr = o.parse;
    evr(2, 0x0100 + pr, "TC frame rejected: %s", tc_parse_result_name(o.parse));
    return;
  }
  ++tc_ok_;
  if (!crc_ok) {
    ++tc_rescued_;
    evr(1, 0x0307, "uplink with LoRa CRC error rescued by BCH/FECF/SDLS (%lu total)",
        (unsigned long)tc_rescued_);
  }
  if (hibernating_) exit_hibernate("authenticated uplink received");

  const TcFrame& f = o.frame;
  const uint32_t t = millis();
  bool contact = false;
  switch (o.verdict) {
    case Farm1::ACCEPT:
    case Farm1::ACCEPT_BYPASS: {
      note_valid_tc(t);
      contact = true;
      // Only an RF frame proves the ground followed the radio change; the hardline
      // umbilical says nothing about the RF link (C19).
      if (revert_armed_ && !hardline) {
        revert_armed_ = false;
        evr(1, 0x0210, "radio change confirmed by ground (code %u, ch %u)", (unsigned)rcfg_.rate_code,
            (unsigned)rcfg_.channel);
      }
      // The source travels beside N(S), never inside it (every N(S) 0..255 is valid).
      const bool ad = o.verdict == Farm1::ACCEPT;
      const uint8_t tc_seq = ad ? f.seq : 0u;
      const CmdSource src = ad ? CMD_SRC_AD : CMD_SRC_BD;
      const uint8_t* u = nullptr;
      size_t un = 0;
      const CmdError he = parse_tc_header(f.data, f.data_len, u, un);
      if (he != CE_OK) cmd_reject(tc_seq, src, 0, he);
      else execute_user(u, un, tc_seq, src);
      break;
    }
    case Farm1::CONTROL_UNLOCK:
      note_valid_tc(t);
      contact = true;
      evr(1, 0x0201, "COP-1 UNLOCK");
      break;
    case Farm1::CONTROL_SET_VR:
      note_valid_tc(t);
      contact = true;
      evr(1, 0x0202, "COP-1 SET V(R)=%u", (unsigned)farm_.vr());
      break;
    case Farm1::DISCARD_RETRANSMIT:
      evr(0, 0x0203, "FARM gap: N(S)=%u V(R)=%u, retransmit requested", (unsigned)f.seq, (unsigned)farm_.vr());
      break;
    case Farm1::DISCARD_NEG_WINDOW:
      evr(0, 0x0204, "FARM duplicate N(S)=%u discarded", (unsigned)f.seq);
      break;
    case Farm1::DISCARD_LOCKOUT:
      evr(3, 0x0205, "FARM LOCKOUT (N(S)=%u V(R)=%u) - ground must UNLOCK", (unsigned)f.seq,
          (unsigned)farm_.vr());
      break;
    case Farm1::CONTROL_INVALID:
    default:
      evr(2, 0x0206, "invalid COP-1 control command");
      break;
  }
  // Ground contact acknowledges the beacon AFTER execution, so the command's own EVRs and
  // state changes are acknowledged with it (autonomy.h BeaconMonitor).
  if (contact) beacon_.on_ground_contact(beacon_sample());
}

// =============================================================================
// Downlink (PB-8.6 item 3 "downlink")
// =============================================================================
uint32_t Flight::busy_estimate_ms() const {
  // Measured busy time of the last transmission; before the first one (or after a
  // radio change) the model's estimate for one CADU.
  return last_airtime_ms_ ? last_airtime_ms_ : radio_.airtime_ms(kCaduLen);
}

uint32_t Flight::period_now_ms() const {
  return frame_period_ms(busy_estimate_ms(), mode_, (fdir_flags_ & FDIR_PA_OVERTEMP) != 0,
                         cmd_frame_period_ms_);
}

uint16_t Flight::duty_permille(uint32_t now) const {
  return duty_.permille(now, tx_state_ == TX_WAIT_DONE, tx_start_ms_, tx_period_ms());
}

uint32_t Flight::tx_period_ms() const {
  // Hibernation: one beacon every beacon_s; the frames after its first at the normal period.
  // After a radio reconfiguration never less than the period owed to the last frame sent
  // at the old settings (hold_period_ms_, datalink.h launch_spacing_ms()).
  const bool beacon_rest = hibernating_ && beacon_frames_left_ > 0;
  const uint32_t p = hibernating_ && !beacon_rest ? (uint32_t)beacon_s_ * 1000u : period_now_ms();
  return launch_spacing_ms(p, hold_period_ms_);
}

void Flight::service_tx(uint32_t now) {
  if (tx_state_ != TX_IDLE) return;                 // the radio reports TX_DONE / TX_TIMEOUT
  if (scan_state_ != SCAN_IDLE) {
    service_scan(now);
    return;
  }
  if (radio_.busy(now)) return;                     // receiving, noise query, recovery ...
  // configure() / set_hibernation() only when the radio is idle (radio.h).
  if (hib_apply_pending_) {
    hib_apply_pending_ = false;
    if (!radio_.set_hibernation(hibernating_, now)) {
      radio_cfg_ok_ = false;
      fdir_flags_ |= FDIR_RADIO_CFG;
    }
    return;
  }
  if (radio_reconfig_pending_) {
    apply_radio_config(now);
    return;
  }
  if (tx_inhibit_) return;
  // A magnetometer sample in progress completes first (<= kMagCollectTimeoutMs): the
  // RM3100s are sampled in PA-off windows.
  if (mag_phase_ == MAG_COLLECT) return;
  // Hibernation: one beacon every beacon_s - the HK packet, preceded only by what still
  // fits in kBeaconMaxFrames frames (the rest of the real-time backlog is in the SSR), the
  // frames after the first at the normal period (PB-1, C20).
  const bool beacon_rest = hibernating_ && beacon_frames_left_ > 0;
  if (now - last_tx_start_ms_ < tx_period_ms()) return;
  if (hibernating_ && !beacon_rest) {
    beacon_frames_left_ = dl_.prepare_beacon(kSpPriHdrLen + kSpSecHdrLen + kHkLen, kBeaconMaxFrames);
    gen_hk(true);                                   // the hibernation beacon HK packet
  }
  if (beacon_frames_left_) --beacon_frames_left_;
  send_next_frame(now);
}

void Flight::send_next_frame(uint32_t now) {
  // Refill the playback VC from the recorder; never more than a routine packet may use,
  // so a packet taken from the SSR always fits (it would otherwise be lost).
  if (ssr_.playing()) {
    for (uint8_t k = 0; k < 4 && dl_.backlog(VC_PLAYBACK) + kMaxPacketLen <= kRoutineVcLimit; ++k) {
      uint8_t p[kMaxPacketLen];
      const uint16_t n = ssr_.next_playback(p, sizeof p);
      if (!n) {
        evr(1, 0x0402, "SSR playback complete");
        break;
      }
      if (!dl_.push(VC_PLAYBACK, p, n)) break;
    }
  }
  Clcw clcw;
  clcw.vcid = 0;
  clcw.no_rf_available = false;
  clcw.no_bit_lock = no_bit_lock_;                  // latched in tick_1hz (no millis() wrap)
  farm_.fill_clcw(clcw);

  uint8_t cadu[kCaduLen];
  DownlinkFrame info;
  dl_.next_cadu(clcw, cadu, info);
  // SCLK of the transmission start (v2); on_tx_end() moves it to the moment the PA was
  // keyed when the radio deferred the transmission (SX126x CAD / LBT).
  const uint64_t sclk_us = sclk_.now_us();
  if (!radio_.transmit(cadu, kCaduLen, now)) {
    ++tx_refused_;                                  // frame lost (the ground sees the count gap)
    return;
  }
  tx_frame_ = info;
  tx_state_ = TX_WAIT_DONE;
  tx_start_ms_ = last_tx_start_ms_ = now;
  hold_period_ms_ = 0;                              // the spacing owed after a reconfiguration is paid
  tx_start_sclk_us_ = sclk_us;
  ++frames_sent_;
  if (info.oid) ++oid_sent_;
  if (spec_.burst_active() && burst_tx_frames_ < 65535u) ++burst_tx_frames_;
  queue_cadu_copy(cadu);                            // EGSE archive copy of what went to the radio
}

void Flight::apply_radio_config(uint32_t now) {
  radio_reconfig_pending_ = false;
  // The period owed to the last frame at the current settings, from its measured busy time,
  // BEFORE that measurement is dropped below (also when configure() fails: the frame was sent).
  hold_period_ms_ = reconfig_hold_ms(hold_period_ms_, period_now_ms());
  if (pending_cfg_valid_) {
    // Coordinated change: only the rate code and the channel move (a TXPWR or RADIOOPT
    // given meanwhile stays in force); the old pair is kept for the automatic revert.
    revert_cfg_ = rcfg_;
    revert_armed_ = true;
    revert_deadline_ms_ = now + revert_window_ms_;
    rcfg_.rate_code = pending_cfg_.rate_code;
    rcfg_.channel = pending_cfg_.channel;
    pending_cfg_valid_ = false;
  }
  radio_cfg_ok_ = radio_.configure(rcfg_, false);
  if (radio_cfg_ok_) fdir_flags_ &= (uint16_t)~FDIR_RADIO_CFG;
  else fdir_flags_ |= FDIR_RADIO_CFG;
  last_airtime_ms_ = 0;                             // re-measure at the new settings
  report_radio(false);
}

// RF spectrum survey: step through the channels, read the ambient noise on each,
// downlink the map (APID 0x015). One step per pass; the downlink pauses meanwhile.
void Flight::service_scan(uint32_t now) {
  switch (scan_state_) {
    case SCAN_SET: {
      if (radio_.busy(now)) return;
      RadioSettings c = rcfg_;
      c.channel = scan_ch_;
      if (!radio_.configure(c, false)) {
        scan_store(kRadioNaI32, now);
        return;
      }
      scan_step_ms_ = now;
      scan_state_ = SCAN_SETTLE;
      return;
    }
    case SCAN_SETTLE:
      if (now - scan_step_ms_ < kScanSettleMs || radio_.busy(now)) return;
      if (radio_.request_noise(now)) {
        scan_step_ms_ = now;
        scan_state_ = SCAN_WAIT_REPLY;
      } else {
        scan_store(kRadioNaI32, now);
      }
      return;
    case SCAN_WAIT_REPLY:
      if (now - scan_step_ms_ > kScanReplyGuardMs) scan_store(kRadioNaI32, now);   // on_noise() normally
      return;
    case SCAN_IDLE:
    default:
      scan_state_ = SCAN_IDLE;
      return;
  }
}

void Flight::scan_store(int32_t dbm, uint32_t now) {
  const uint8_t i = (uint8_t)(scan_ch_ - scan_first_);
  if (i < kRfscanMaxChannels) {
    // -128 is the "no reading" sentinel: a real value is kept within -127..127.
    scan_noise_[i] = dbm == kRadioNaI32 ? (int8_t)-128
                     : dbm < -127      ? (int8_t)-127
                     : dbm > 127       ? (int8_t)127
                                       : (int8_t)dbm;
  }
  if (scan_ch_ < scan_last_) {
    ++scan_ch_;
    scan_state_ = SCAN_SET;
    return;
  }
  const uint8_t count = (uint8_t)(scan_last_ - scan_first_ + 1u);
  uint8_t b[kMaxPayload];
  const size_t n = pack_rfscan(scan_first_, count, sat16(now - scan_t0_), scan_noise_, b);
  if (n) (void)emit(APID_RFSCAN, b, n, VC_RT_ENG);
  int best = 127;
  uint8_t best_ch = scan_first_;
  for (uint8_t k = 0; k < count && k < kRfscanMaxChannels; ++k) {
    if (scan_noise_[k] != -128 && scan_noise_[k] < best) {
      best = scan_noise_[k];
      best_ch = (uint8_t)(scan_first_ + k);
    }
  }
  evr(1, 0x0303, "RF survey done in %lu ms: quietest CH%u (%d dBm)", (unsigned long)(now - scan_t0_),
      (unsigned)best_ch, best);
  scan_state_ = SCAN_IDLE;
  radio_reconfig_pending_ = true;                   // restore the operational channel
}

// Hibernation: the radio listens duty-cycled (E22 Wake-on-Radio, 2 s cycle; SX126x
// duty-cycled RX for a kSxWakePreambleSym preamble); the spacecraft sends one HK beacon
// every beacon_s and otherwise records only. The ground wakes it with the WAKE directive.
void Flight::enter_hibernate(uint16_t beacon_s) {
  beacon_s_ = beacon_s;
  rcfg_.wor_cycle = 3;                             // (3 + 1) x 500 ms = 2 s E22 wake cycle
  hibernating_ = true;
  fdir_flags_ |= FDIR_HIBERNATE;
  hib_apply_pending_ = true;                       // set_hibernation() when the radio is idle
  evr(2, 0x0800, "HIBERNATE: duty-cycled receive, beacon every %u s", (unsigned)beacon_s);
}

void Flight::exit_hibernate(const char* why) {
  if (!hibernating_) return;
  hibernating_ = false;
  beacon_frames_left_ = 0;
  fdir_flags_ &= (uint16_t)~FDIR_HIBERNATE;
  hib_apply_pending_ = true;
  evr(2, 0x0801, "WAKE: %s", why);
}

// =============================================================================
// Commanding (PB-2, PB-8.6 item 5)
// =============================================================================
void Flight::cmd_verify(uint8_t seq, CmdSource source, uint8_t opcode, uint8_t stage, uint8_t err, uint32_t tag) {
  CmdVerPacket p{seq, opcode, stage, err, tag, source};
  uint8_t b[kCmdVerLen];
  (void)emit(APID_CMDVER, b, pack_cmdver(p, b), VC_RT_ENG, true, true);   // priority (PB-1.2)
}

void Flight::cmd_reject(uint8_t tc_seq, CmdSource source, uint8_t opcode, CmdError e) {
  ++cmd_rej_;
  last_opcode_ = opcode;
  last_status_ = e;
  cmd_verify(tc_seq, source, opcode, STAGE_FAILED, e, 0);
  evr(2, 0x0500 + e, "command 0x%02X rejected, error %u", (unsigned)opcode, (unsigned)e);
}

void Flight::set_mode(uint8_t m, const char* why) {
  if (m > MODE_TEST) return;
  if (hibernating_) exit_hibernate("mode change");
  const uint8_t old = mode_;
  mode_ = m;
  for (uint8_t i = 0; i < kNumPeriodic; ++i) last_gen_s_[i] = 0;
  evr(1, 0x0010 + m, "MODE %s -> %s (%s)", fsw_mode_name(old), fsw_mode_name(m), why);
}

// SAFE commanded by fault protection (or boot): stored sequences stop (contract 24.2).
void Flight::enter_fdir_safe(const char* why) {
  set_mode(MODE_SAFE, why);
  safe_by_fdir_ = true;
}

void Flight::execute_user(const uint8_t* u, size_t n, uint8_t tc_seq, CmdSource source) {
  Command c;
  const CmdError pe = parse_user_data(u, n, c);
  if (pe != CE_OK) {
    cmd_reject(tc_seq, source, c.opcode, pe);
    return;
  }
  const uint32_t now = millis();
  const bool stored = source == CMD_SRC_STORED;
  uint8_t result = CE_OK;
  uint32_t tag = 0;
  switch (c.opcode) {
    case OP_NOOP:
      break;
    case OP_MODE:
      set_mode(c.a8, stored ? "stored sequence" : "ground command");
      safe_by_fdir_ = false;
      break;
    case OP_TXPWR:
      rcfg_.power_code = c.a8;
      radio_reconfig_pending_ = true;               // applied when the radio is idle
      evr(1, 0x0214, "TXPWR code %u = %d dBm (%s)", (unsigned)c.a8,
          (int)radio_tx_power_dbm(radio_.model(), c.a8, kSxPaGainDb), radio_model_name(radio_.model()));
      break;
    case OP_AIRRATE:
      // Coordinated change after two more frames at the old rate (so the ground sees this
      // verification first); automatic revert unless a valid TC arrives on the new rate.
      if (!pending_cfg_valid_) pending_cfg_ = rcfg_;
      pending_cfg_.rate_code = c.a8;
      pending_cfg_valid_ = true;
      revert_window_ms_ = (uint32_t)c.a16 * 1000u;
      cfg_change_after_frames_ = 2;
      evr(2, 0x0211, "AIR RATE -> code %u in 2 frames; revert in %u s without uplink", (unsigned)c.a8,
          (unsigned)c.a16);
      break;
    case OP_CHANNEL: {
      if (!pending_cfg_valid_) pending_cfg_ = rcfg_;
      pending_cfg_.channel = c.a8;
      pending_cfg_valid_ = true;
      revert_window_ms_ = (uint32_t)c.a16 * 1000u;
      cfg_change_after_frames_ = 2;
      const uint32_t khz = radio_channel_freq_hz(c.a8) / 1000u;   // 410125 + 1000 ch
      evr(2, 0x0212, "CHANNEL -> %u (%lu.%03lu MHz) in 2 frames; revert in %u s without uplink",
          (unsigned)c.a8, (unsigned long)(khz / 1000u), (unsigned long)(khz % 1000u), (unsigned)c.a16);
      break;
    }
    case OP_FPERIOD:
      cmd_frame_period_ms_ = c.a16;
      break;
    case OP_PKTRATE: {
      static const uint16_t kApids[kNumPeriodic] = {APID_HK, APID_RF, APID_TIMECORR, APID_MAG,
                                                    APID_ATT, APID_SPEC, APID_ENV};
      result = CE_BAD_ARGUMENT;                     // parse_user_data already checked the APID
      for (uint8_t i = 0; i < kNumPeriodic; ++i) {
        if (kApids[i] == c.a16) {
          period_override_[i] = c.b16 ? c.b16 : (uint16_t)0xFFFF;
          result = CE_OK;
        }
      }
      break;
    }
    case OP_PLAYBACK:
      if (c.a8) {
        if (!ssr_.start_playback()) result = CE_BUSY;     // an SSR export is running
      } else {
        ssr_.stop_playback();
      }
      if (result == CE_OK)
        evr(1, 0x0401, "SSR playback %s (%lu packets)", c.a8 ? "START" : "STOP",
            (unsigned long)ssr_.packets());
      break;
    case OP_SSRCLEAR:
      if (ssr_.exporting()) {
        result = CE_BUSY;
      } else {
        ssr_.clear();
        dl_.reset_vc(VC_PLAYBACK);
      }
      break;
    case OP_PING:
      tag = c.a32;
      break;
    case OP_SENSORS:
      sensor_enable_ = c.a16;
      break;
    case OP_RSTCNT:
      cmd_acc_ = cmd_rej_ = tc_ok_ = tc_bad_ = cltu_ok_ = cltu_bad_ = 0;
      aux_timeouts_ = loop_overruns_ = 0;
      loop_max_ms_ = 0;
      fdir_flags_ = fdir_after_rstcnt(fdir_flags_);   // acknowledges the event-latched FDIR flags
      break;
    case OP_REBOOT: {
      // After 2 more frames (the CMDVER goes out first, PB-2.3), but never later than two
      // frame periods plus one frame's busy time, at least kRebootMaxWaitMs: a dead radio,
      // a refused launch or a TX inhibit sends no frame at all (fdir_1hz, C18).
      reboot_pending_ = true;
      reboot_after_frames_ = 2;
      const uint32_t bound = 2u * period_now_ms() + busy_estimate_ms();
      reboot_deadline_ms_ = now + (bound > kRebootMaxWaitMs ? bound : kRebootMaxWaitMs);
      break;
    }
    case OP_MAGCC:
      // Never between POLL and collect (C29): a CC register write clears DRDY (HSHAKE
      // DRC0 = 1, RM3100 manual 5.6.2) and the conversion would be scaled with the new
      // gain. Applied now when no conversion is pending, else by service_mag() at its end.
      if (!mag_ob_.ok() && !mag_ib_.ok()) {
        result = CE_HARDWARE;
        break;
      }
      mag_cc_ = c.a16;
      mag_cc_pending_ = true;
      if (!mag_ob_.pending() && !mag_ib_.pending() && !apply_mag_cc()) result = CE_HARDWARE;
      break;
    case OP_CMDLOSS:
      cmd_loss_s_ = c.a32;
      note_valid_tc(now);
      break;
    case OP_FDIRMASK:
      fdir_mask_ = c.a16;
      break;
    case OP_TXINHIBIT:
      tx_inhibit_ = true;
      tx_inhibit_until_ms_ = now + (uint32_t)c.a16 * 1000u;
      fdir_flags_ |= FDIR_TX_INHIBIT;
      break;
    case OP_EVRLEVEL:
      evr_level_ = c.a8;
      break;
    case OP_TIMECORR:
      timecorr_request_ = true;                     // after the next reference frame (PB-2.3)
      break;
    case OP_RFSCAN:
      if (scan_state_ != SCAN_IDLE) {
        result = CE_BUSY;
        break;
      }
      scan_first_ = c.a8;
      scan_last_ = c.b8;
      scan_ch_ = scan_first_;
      scan_t0_ = now;
      for (uint8_t i = 0; i < kRfscanMaxChannels; ++i) scan_noise_[i] = -128;
      scan_state_ = SCAN_SET;
      evr(1, 0x0302, "RF survey CH%u..CH%u starting (downlink paused)", (unsigned)scan_first_,
          (unsigned)scan_last_);
      break;
    case OP_HIBERNATE:
      enter_hibernate(c.a16);
      break;
    case OP_SPECCFG: {
      SpecConfig cfg = spec_cfg_;
      cfg.gain = c.a8;
      cfg.int_cycles = c.b8;
      cfg.lamps = c.c8;
      cfg.led_cur = c.d8;
      cfg.ind = c.e8;
      if (!spec_config_valid(cfg)) {                // e.g. LOCKIN with lamps 0
        result = CE_BAD_ARGUMENT;
        break;
      }
      spec_cfg_ = cfg;                              // applies at the next cycle
      no_lamp_reported_ = false;
      if (!spec_.ok()) evr(2, 0x0707, "AS7265X %s", "not responding: SPECCFG stored for later");
      break;
    }
    case OP_CFDPPUT:
      result = cmd_cfdp_put(c);
      break;
    case OP_CFDPCANCEL:
      cmd_cfdp_cancel();                            // always CE_OK (idempotent)
      break;
    case OP_RADIOOPT:
      rcfg_.lbt = (c.a8 & 1u) != 0;
      rcfg_.rx_boost = (c.a8 & 2u) != 0;
      radio_reconfig_pending_ = true;
      evr(1, 0x0213, "RADIOOPT LBT/CAD %s, Rx boost %s", rcfg_.lbt ? "on" : "off", rcfg_.rx_boost ? "on" : "off");
      break;
    case OP_SPECMODE:
      result = cmd_specmode(c);
      break;
    case OP_SPECBASE:
      if (!spec_proc_.set_baseline_cmd(c.a16)) result = CE_BAD_ARGUMENT;
      break;
    case OP_SPECDIAG:
      if (spec_.state() == As7265x::ST_ABSENT) result = CE_HARDWARE;
      else if (!spec_.request_diag(c.a8, c.b8)) result = CE_BUSY;   // a dump is queued
      break;
    case OP_SEQLOAD:
      result = cmd_seqload(c);
      break;
    case OP_SEQCTRL:
      result = cmd_seqctrl(c);
      break;
    case OP_MAGBIST:
      result = cmd_magbist(c.a8);
      break;
    case OP_MAGCAL:
      result = cmd_magcal(c);
      break;
    default:
      result = CE_UNKNOWN_OPCODE;                   // unreachable: parse_user_data knows 0x01..0x20
      break;
  }
  last_opcode_ = c.opcode;
  last_status_ = result;
  if (result == CE_OK) ++cmd_acc_;
  else ++cmd_rej_;
  cmd_verify(tc_seq, source, c.opcode, result == CE_OK ? STAGE_EXECUTED : STAGE_FAILED, result, tag);
  LOGF("INFO", "CMD 0x%02X src=%u seq=%u -> %s", (unsigned)c.opcode, (unsigned)source, (unsigned)tc_seq,
       result == CE_OK ? "EXECUTED" : "FAILED");
}

// CFDPPUT (PB-2.5): source 0 = the SSR contents, sent by the MCU; 1 / 2 = an EGSE file
// relayed through cfdp_pdu under the RelayGate's authorisation.
uint8_t Flight::cmd_cfdp_put(const Command& c) {
  // Transaction numbers are unique across boots only through the partition (the EGSE boot
  // counter): with partition 0 every boot would reuse 1, 2, ... (PB-1.13).
  if (sclk_.partition == 0) {
    evr(2, 0x0A06, "CFDPPUT refused: no SCLK partition from the EGSE yet");
    return CE_BUSY;
  }
  if (cfdp_tx_.active() || relay_gate_.state() != RelayGate::NONE) return CE_BUSY;
  const uint16_t n = (cfdp_n_ >= 0xFFFEu) ? (uint16_t)1u : (uint16_t)(cfdp_n_ + 1u);   // never 0
  if (c.a8 == 0) {
    if (ssr_.playing() || !ssr_.begin_export()) return CE_BUSY;   // begin_export pauses recording
    char name[kCfdpMaxNameLen + 1];
    const size_t nl = cfdp_ssr_file_name(name, sizeof name, sclk_.partition, sclk_.seconds());
    const uint32_t seq = cfdp_make_seq(sclk_.partition, n);
    if (nl == 0 || !cfdp_tx_.begin(seq, name, &ssr_src_, (uint32_t)c.a16 * 1024u)) {
      ssr_.end_export();
      return CE_HARDWARE;
    }
    cfdp_n_ = n;
    cfdp_ssr_active_ = true;
    cfdp_paused_base_ = ssr_.paused_drops();
    cfdp_last_seq_ = seq;
    cfdp_last_pm_ = 0;
    evr(1, 0x0A00, "CFDP SSR export %s: %lu B seq %lu", name, (unsigned long)cfdp_tx_.file_size(),
        (unsigned long)seq);
    return CE_OK;
  }
  const uint32_t seq = kCfdpEgseSeqFlag | cfdp_make_seq(sclk_.partition, n);
  const int w = snprintf(cfdp_req_text_, sizeof cfdp_req_text_, "%u,%lu,%u", (unsigned)c.a8,
                         (unsigned long)seq, (unsigned)c.a16);
  if (w <= 0 || (size_t)w >= sizeof cfdp_req_text_) return CE_HARDWARE;   // cannot happen: <= 18
  cfdp_n_ = n;
  relay_gate_.request(seq, millis());
  cfdp_req_pending_ = true;                         // notify("cfdp_req") when the UART has room
  cfdp_last_seq_ = seq;
  cfdp_last_pm_ = 0;
  evr(1, 0x0A03, "CFDP relay requested: source %u seq %lu max %u KiB", (unsigned)c.a8,
      (unsigned long)seq, (unsigned)c.a16);
  return CE_OK;
}

void Flight::cmd_cfdp_cancel() {
  char what[40];
  if (cfdp_tx_.active()) {
    cfdp_tx_.cancel();                              // the next PDU is EOF(cancel, condition 15)
    (void)snprintf(what, sizeof what, "SSR export seq %lu", (unsigned long)cfdp_tx_.seq());
  } else if (relay_gate_.cancel(millis())) {
    // The EGSE's EOF(cancel) is still admitted, so the ground learns the outcome.
    cfdp_cancel_seq_ = relay_gate_.seq();
    cfdp_cancel_pending_ = true;
    (void)snprintf(what, sizeof what, "relay seq %lu", (unsigned long)relay_gate_.seq());
  } else if (relay_gate_.state() == RelayGate::CANCELLING) {
    (void)snprintf(what, sizeof what, "relay seq %lu already cancelling", (unsigned long)relay_gate_.seq());
  } else {
    (void)snprintf(what, sizeof what, "nothing active");
  }
  evr(1, 0x0A02, "CFDP cancel: %s", what);
}

uint8_t Flight::cmd_specmode(const Command& c) {
  SpecConfig cfg = spec_cfg_;
  cfg.mode = c.a8;
  cfg.n = c.b8;
  if (!spec_config_valid(cfg)) return CE_BAD_ARGUMENT;      // e.g. LOCKIN without a lamp
  if (spec_.burst_active() && cfg.mode != SPEC_BURST) spec_.abort();
  spec_cfg_ = cfg;                                  // takes effect at the next cycle
  no_lamp_reported_ = false;
  // A commanded burst starts at the next opportunity, whatever the SPEC cadence of the
  // mode (SAFE has none); later bursts follow the SPEC cadence like any other mode.
  if (cfg.mode == SPEC_BURST) spec_start_req_ = true;
  return CE_OK;
}

uint8_t Flight::cmd_magbist(uint8_t unit) {
  const uint8_t fitted = (uint8_t)((mag_ob_.ok() ? 1u : 0u) | (mag_ib_.ok() ? 2u : 0u));
  const uint8_t mask = (uint8_t)(magbist_unit_mask(unit) & fitted);
  if (!mask) return CE_HARDWARE;
  if (bist_pending_) return CE_BUSY;
  bist_pending_ = mask;                             // next PA-off window with every lamp off
  bist_wait_t0_ = millis();
  return CE_OK;
}

uint8_t Flight::cmd_seqload(const Command& c) {
  SeqLoadReport rep = SeqLoadReport();
  const SeqStatus st = seq_.load(c.args, c.nargs, sclk_.seconds(), rep);
  if (st == SEQ_OK) {
    evr(1, 0x0900, "SEQ slot %u loaded: %s %lu s op 0x%02X%s", (unsigned)rep.slot, rep.relative ? "T+" : "SCLK",
        (unsigned long)rep.t_s, (unsigned)rep.opcode, rep.replaced ? " replaced" : "");
  } else {
    evr(2, 0x0901, "SEQLOAD refused: %s (cmd error %u)", seq_status_text(st), (unsigned)rep.cmd_error);
  }
  return seq_cmd_error(st);
}

uint8_t Flight::cmd_seqctrl(const Command& c) {
  const SeqStatus st = seq_.control(c.a8, c.b8, sclk_.seconds(), safe_by_fdir_);
  static const char* const kAction[4] = {"START", "STOP", "CLEAR_ALL", "DELETE"};
  char what[24];
  if (c.a8 == SEQ_DELETE_SLOT) (void)snprintf(what, sizeof what, "DELETE slot %u", (unsigned)c.b8);
  else (void)snprintf(what, sizeof what, "%s", c.a8 < 4 ? kAction[c.a8] : "?");
  if (st == SEQ_OK) evr(1, 0x0902, "SEQCTRL %s", what);
  else evr(2, 0x0903, "SEQCTRL %s refused: %s", what, seq_status_text(st));
  return seq_cmd_error(st);
}

uint8_t Flight::cmd_magcal(const Command& c) {
  uint8_t unit = 0;
  const MagCalStatus st = magcal_.load(c.args, c.nargs, unit);
  if (st == MAGCAL_OK) {
    char t[kEvrTextMax + 1];
    (void)magcal_evr_text(unit, magcal_.coeffs(unit), t, sizeof t);
    evr(1, 0x0912, "%s", t);
  } else {
    evr(2, 0x0913, "MAGCAL refused: %s", magcal_status_text(st));
  }
  return magcal_cmd_error(st);
}

// =============================================================================
// Packets, EVRs and the 1 Hz tick
// =============================================================================
bool Flight::emit(uint16_t apid, const uint8_t* payload, size_t n, uint8_t vc, bool record, bool priority) {
  const uint8_t si = apid_index(apid);
  if (si == kApidIndexNone) {                       // never borrow another APID's counter (PB-1.1)
    ++emit_refused_;
    return false;
  }
  uint8_t pkt[kMaxPacketLen];
  const size_t len = build_tm_packet(pkt, sizeof pkt, apid, apid_seq_[si], sclk_.cuc(), payload, n);
  if (!len) {
    ++emit_refused_;
    return false;
  }
  apid_seq_[si] = (uint16_t)((apid_seq_[si] + 1u) & 0x3FFFu);
  if (record) ssr_.record(pkt, (uint16_t)len);
  // Under congestion science is recorded only (play it back later); while hibernating
  // every routine packet is (the beacon HK and priority packets still go out). VC3 always
  // queues: CFDP PDUs are not recorded.
  if (vc == VC_RT_SCI && (fdir_flags_ & FDIR_VC_CONGEST) && (fdir_mask_ & FDIR_VC_CONGEST)) return true;
  if (hibernating_ && !priority && vc != VC_FILE) return true;
  return dl_.push(vc, pkt, len, priority);
}

void Flight::evr(uint8_t sev, uint16_t id, const char* fmt, ...) {
  char text[kEvrTextMax + 1];                       // pack_evr sends at most 80 characters
  va_list ap;
  va_start(ap, fmt);
  const int r = vsnprintf(text, sizeof text, fmt, ap);
  va_end(ap);
  if (r < 0) text[0] = '\0';                        // encoding error: the id alone
  if (sev > 4) sev = 4;
  // 1. The beacon sees every EVR, before any filter (contract 24.4).
  beacon_.note_evr(sev, id);
  // 2. EGSE event log: every EVR, subject only to the notification rules (PB-0.4). The
  // per-pass limit bounds the time one loop pass spends on notifications; setup() is not
  // a loop pass, so there only the per-second limit and the UART room check apply.
  const uint32_t window = millis() / 1000u;
  if (window != evr_note_window_) {
    evr_note_window_ = window;
    evr_notes_sec_ = 0;
  }
  char note[kEvrTextMax + 16];
  const int nn = snprintf(note, sizeof note, "0x%04X %s %s", (unsigned)id, kSevName[sev], text);
  const size_t len = nn > 0 ? umin32((uint32_t)nn, (uint32_t)(sizeof note - 1u)) : 0u;
  const bool pass_ok = in_setup_ || evr_notes_pass_ < kEvrNotifyMaxPerPass;
  if (len > 0 && pass_ok && evr_notes_sec_ < kEvrNotifyMaxPerS && notify_room(len)) {
    Bridge.notify("sc_evr", text_string(note, len));
    ++evr_notes_pass_;
    ++evr_notes_sec_;
  } else {
    ++evr_nd_;
  }
  LOGF(kSevName[sev], "EVR 0x%04X %s", (unsigned)id, text);
  // 3. Level filter.
  if (sev < evr_level_) return;
  // 4. Routine-EVR budget (EvrGate): boot EVRs, the SDLS epoch EVRs and SPECDIAG lines
  // are exempt; severity >= 3 is never throttled.
  const bool exempt = in_setup_ || id == 0x0120 || id == 0x0121 || id == 0x0122 || id == 0x0703;
  if (!evr_gate_.admit(sev, exempt)) return;
  // 5. Downlink: warnings, errors and the epoch EVRs use the VC0 priority reserve.
  const bool priority = sev >= 2 || (id >= 0x0120 && id <= 0x0122);
  uint8_t b[kMaxPayload];
  (void)emit(APID_EVR, b, pack_evr(sev, id, text, b), VC_RT_ENG, true, priority);
}

void Flight::periods_in_force(uint16_t period_s[kNumPeriodic]) const {
  const uint8_t m = mode_ <= MODE_TEST ? mode_ : (uint8_t)MODE_SAFE;
  for (uint8_t i = 0; i < kNumPeriodic; ++i) {
    const uint16_t o = period_override_[i];
    period_s[i] = o == 0xFFFFu ? (uint16_t)0u : o ? o : kModeCadence[m][i];
  }
}

void Flight::tick_1hz(uint32_t now) {
  const uint32_t t = sclk_.seconds();
  // CLCW No Bit Lock (v2): no CLTU decoded for 5 min. Latched once set, so the 2^32 ms
  // millis() wrap cannot clear it again (process_tc clears it).
  if (!no_bit_lock_ && now - last_cltu_ms_ > kNoBitLockMs) no_bit_lock_ = true;
  // Seconds since the last valid TC, saturating (the ms reference never lags > ~3 s).
  const uint32_t whole_s = (now - tc_age_ref_ms_) / 1000u;
  if (whole_s) {
    tc_age_ref_ms_ += whole_s * 1000u;
    tc_age_s_ = tc_age_s_ > 0xFFFFFFFFu - whole_s ? 0xFFFFFFFFu : tc_age_s_ + whole_s;
  }
  sample_due_ = true;                               // taken in the next PA-off window

  // Downlink load plan (PB-3.3, C-27): periodic packets stretched to <= 75 % of the
  // measured capacity, routine EVRs get the rest up to 95 %.
  uint16_t per[kNumPeriodic];
  periods_in_force(per);
  load_ = plan_downlink_load(per, period_now_ms(), (uint16_t)dl_.data_field_len());
  const uint32_t s = load_.stretch_x100, rep = stretch_reported_;
  if ((s > rep ? s - rep : rep - s) * 10u >= rep) {
    stretch_reported_ = load_.stretch_x100;
    evr(1, 0x0215, "downlink load: packet periods x%u.%02u (capacity %lu B/min)", (unsigned)(s / 100u),
        (unsigned)(s % 100u), (unsigned long)load_.capacity_octets_per_min);
  }
  evr_gate_.refill(now - last_refill_ms_, load_.evr_milli_per_s);
  last_refill_ms_ = now;

  for (uint8_t i = 0; i < kNumPeriodic; ++i) {
    const uint16_t period = stretched_period_s(per[i], load_.stretch_x100);
    if (!period) continue;
    if (last_gen_s_[i] == 0 || t - last_gen_s_[i] >= period) {
      last_gen_s_[i] = t ? t : 1u;
      gen_periodic(i);
    }
  }
  if (t - last_callsign_s_ >= kCallsignPeriodS) {
    last_callsign_s_ = t;
    evr(1, 0x0002, "DE %s", VGQ_CALLSIGN);
  }
  // Noise-floor sampling while the channel is quiet.
  if (radio_cfg_ok_ && tx_state_ == TX_IDLE && scan_state_ == SCAN_IDLE && !hibernating_ &&
      now - last_noise_ms_ > kNoiseSampleMs && now - last_tx_start_ms_ > kNoiseAfterTxMs &&
      !radio_.busy(now) && radio_.request_noise(now))
    last_noise_ms_ = now;
  fdir_1hz(now);
  (void)beacon_.update(beacon_sample());
  status_due_ = true;                               // sc_status 1 Hz, sc_status_x every 5 s
  if (++status_x_div_ >= 5u) {
    status_x_div_ = 0;
    status_x_due_ = true;
  }
}

void Flight::gen_periodic(uint8_t idx) {
  switch (idx) {
    case PER_HK: gen_hk(false); break;
    case PER_RF: gen_rf(); break;
    case PER_TIMECORR: gen_timecorr(); break;
    case PER_MAG: gen_mag(); break;
    case PER_ATT: gen_att(); break;
    case PER_SPEC:                                  // event-driven packet: start a cycle
      if (sensor_enable_ & SNS_AS7265X) spec_start_req_ = true;
      break;
    case PER_ENV: gen_env(); break;
    default: break;
  }
}

BeaconSample Flight::beacon_sample() const {
  BeaconSample s;
  s.fdir_flags = fdir_flags_;
  s.sensor_health = sensor_health_;
  s.sensor_enable = sensor_enable_;
  s.ssr_dropped = ssr_.dropped();
  s.seq_state = seq_.state();
  s.safe_by_fdir = safe_by_fdir_;
  return s;
}

void Flight::cfdp_hk(uint8_t& state, uint32_t& seq, uint16_t& pm) const {
  if (cfdp_tx_.active()) {
    state = kCfdpHkSsr;
    seq = cfdp_tx_.seq();
    pm = cfdp_tx_.progress_permille();
  } else if (relay_gate_.state() != RelayGate::NONE) {
    state = kCfdpHkRelay;
    seq = relay_gate_.seq();
    pm = relay_.seq() == seq ? relay_.progress_permille() : (uint16_t)0u;
  } else {
    state = kCfdpHkIdle;
    seq = cfdp_last_seq_;
    pm = cfdp_last_pm_;
  }
}

void Flight::gen_hk(bool beacon) {
  HkPacket p{};
  p.fsw_mode = mode_;
  p.sclk_partition = sclk_.partition;
  p.uptime_s = sclk_.seconds();
  p.reset_cause = reset_cause_;
  p.fdir_flags = fdir_flags_;
  p.sensor_health = sensor_health_;
  p.cmd_accepted = cmd_acc_;
  p.cmd_rejected = cmd_rej_;
  p.cmd_last_opcode = last_opcode_;
  p.cmd_last_status = last_status_;
  p.tc_frames_ok = tc_ok_;
  p.tc_frames_bad = tc_bad_;
  p.farm_state = farm_.state();
  p.farm_vr = farm_.vr();
  p.cmd_loss_timer_s = tc_age_s_;                  // time since the last valid TC (no millis() wrap)
  p.bus_temp_cC = clamp_i16(bus_temp_c_ * 100.0f);
  p.radio_fault = radio_fault_code_;
  p.radio_fault_reports = radio_fault_reports_;
  p.loop_max_ms = loop_max_ms_;
  p.loop_overruns = loop_overruns_;
  p.i2c_errors = sat16(bus_.errors() + qwiic_.errors());
  p.ssr_fill_permille = ssr_.fill_permille();
  // C-06: overwrite drops (beacon) + export-pause drops, saturated.
  const uint64_t drops = (uint64_t)ssr_.dropped() + ssr_.paused_drops();
  p.ssr_dropped = drops > 65535u ? (uint16_t)65535u : (uint16_t)drops;
  p.ssr_kib = sat16((uint32_t)(ssr_.capacity() / 1024u));
  p.vc0_backlog = sat16((uint32_t)dl_.backlog(0));
  p.vc1_backlog = sat16((uint32_t)dl_.backlog(1));
  p.vc2_backlog = sat16((uint32_t)dl_.backlog(2));
  p.vc3_backlog = sat16((uint32_t)dl_.backlog(3));
  p.sdls_tc_service = sdls_tc_.service();
  p.sdls_tm_service = sdls_tm_.service();
  p.sdls_auth_fail = sat16(sdls_tc_.auth_failures());
  p.sdls_last_sn = sdls_tc_.last_sn();
  p.sdls_tm_epoch = sdls_tm_.epoch();
  p.sdls_tm_state = sdls_tm_.state();
  cfdp_hk(p.cfdp_state, p.cfdp_seq, p.cfdp_progress_permille);
  p.seq_state = seq_.state();
  p.seq_count = seq_.count();
  p.seq_next_dt_s = seq_.next_dt_s(p.uptime_s);
  p.mag_bist = mag_bist_hk(bist_ob_, bist_ib_);
  p.magcal_state = magcal_.state();
  p.beacon_level = beacon_.level();
  loop_max_ms_ = 0;
  uint8_t b[kHkLen];
  (void)emit(APID_HK, b, pack_hk(p, b), VC_RT_ENG, true, beacon);
}

void Flight::gen_rf() {
  RfPacket p{};
  p.radio_model = radio_.model();
  p.air_rate_code = rcfg_.rate_code;
  p.tx_power_code = rcfg_.power_code;
  p.channel = rcfg_.channel;
  p.radio_cfg_ok = radio_.config_ok() ? 1u : 0u;
  p.framing = dl_.framing() == FRAMING_USLP ? 1u : 0u;
  p.frames_sent = frames_sent_;
  p.oid_frames_sent = oid_sent_;
  p.tx_airtime_ms_total = airtime_total_ms_;
  p.tx_duty_permille = duty_permille(millis());
  p.frame_period_ms = sat16(period_now_ms());
  p.aux_timeouts = aux_timeouts_;
  p.uplink_rssi_dbm = tlm_na_i16(uplink_rssi_);
  p.uplink_snr_cdb = tlm_na_i16(uplink_snr_cdb_);
  p.uplink_freq_err_hz = tlm_na_i32(uplink_ferr_hz_);
  p.noise_floor_dbm = tlm_na_i16(noise_dbm_);
  p.cltu_ok = cltu_ok_;
  p.cltu_bad = cltu_bad_;
  p.bch_corrected = sat16(bch_.codeblocks_corrected);
  p.rx_bytes = radio_.rx_bytes();
  p.mcfc = dl_.mcfc();
  p.last_airtime_ds = (uint8_t)umin32(last_airtime_ms_ / 100u, 255u);
  p.lbt_busy = radio_.lbt_deferrals();
  p.flags = radio_.rf_flags();
  uint8_t b[kRfLen];
  (void)emit(APID_RF, b, pack_rf(p, b), VC_RT_ENG);
}

void Flight::gen_timecorr() {
  if (!tc_ref_valid_) {                             // no reference frame yet: use the next one
    timecorr_request_ = true;
    return;
  }
  TimeCorrPacket p{};
  p.ref_mcfc = tc_ref_count_;
  p.sclk_coarse = (uint32_t)(tc_ref_sclk_us_ / 1000000u);
  p.sclk_fine = (uint16_t)(((tc_ref_sclk_us_ % 1000000u) << 16) / 1000000u);
  p.air_rate_code = tc_ref_rate_;
  p.ref_airtime_ms = sat16(tc_ref_airtime_ms_);
  uint8_t b[kTimeCorrLen];
  (void)emit(APID_TIMECORR, b, pack_timecorr(p, b), VC_RT_ENG);
}

void Flight::gen_mag() {
  MagPacket p{};
  uint8_t n = mstat_ob_.count();
  if (mstat_ib_.count() > n) n = mstat_ib_.count();
  if (mstat_body_.count() > n) n = mstat_body_.count();
  p.nsamples = n;
  p.flags = (uint8_t)(bit_if(mag_tx_keyed_, MAG_F_PA_KEYED) | bit_if(mstat_ob_.count() != 0, MAG_F_OB) |
                      bit_if(mstat_ib_.count() != 0, MAG_F_IB) | bit_if(mstat_body_.count() != 0, MAG_F_BMM150) |
                      bit_if(mag_lamp_, MAG_F_LAMP) | bit_if(magcal_.state() != 0, MAG_F_CAL));
  p.outboard = mag_vec(mstat_ob_, mag_ob_.ok());
  p.inboard = mag_vec(mstat_ib_, mag_ib_.ok());
  p.body = mag_vec(mstat_body_, true);
  p.rm3100_cycle_count = mag_ob_.ok() ? mag_ob_.cycle_count() : mag_ib_.cycle_count();
  mstat_ob_.reset();
  mstat_ib_.reset();
  mstat_body_.reset();
  mag_tx_keyed_ = false;
  mag_lamp_ = false;
  uint8_t b[kMagLen];
  (void)emit(APID_MAG, b, pack_mag(p, b), VC_RT_SCI);
}

// Independent attitude: TRIAD from gravity (accelerometer, primary) and the field, valid
// only while the accelerometer sees ~1 g. Field source (F-23): the calibrated boom RM3100
// (outboard, then inboard; MagCalStore applies B = M (B_raw - b), identity when cleared),
// rotated into body axes, else the BMM150.
bool Flight::triad(Quat& q, bool& from_rm3100) {
  from_rm3100 = false;
  if (!aru_valid_ || !(aru_last_.motion_flags & 2u)) return false;
  const AruReading& r = aru_last_;
  const Vec3 a{r.acc_mg[0] * 0.001f, r.acc_mg[1] * 0.001f, r.acc_mg[2] * 0.001f};
  const float an = v_norm(a);
  if (!(an > 0.9f && an < 1.1f)) return false;
  Vec3 m{0.0f, 0.0f, 0.0f};
  bool have = false;
  for (uint8_t u = 0; u < kMagUnits && !have; ++u) {
    float cal[3];
    if (!rm_fresh_[u] || !magcal_.apply(u, rm_ut_[u], cal)) continue;
    m.x = kRm3100ToBody[0][0] * cal[0] + kRm3100ToBody[0][1] * cal[1] + kRm3100ToBody[0][2] * cal[2];
    m.y = kRm3100ToBody[1][0] * cal[0] + kRm3100ToBody[1][1] * cal[1] + kRm3100ToBody[1][2] * cal[2];
    m.z = kRm3100ToBody[2][0] * cal[0] + kRm3100ToBody[2][1] * cal[1] + kRm3100ToBody[2][2] * cal[2];
    have = from_rm3100 = true;
  }
  if (!have && (r.motion_flags & 8u)) {
    m = Vec3{last_mag_ut_[0], last_mag_ut_[1], last_mag_ut_[2]};
    have = true;
  }
  if (!have) return false;
  return triad_ned(a, m, kGeomagInclDeg, kGeomagDeclDeg, q);
}

void Flight::gen_att() {
  AttPacket p{};
  for (uint8_t i = 0; i < 3; ++i) p.acc_mg[i] = p.gyro_ddps[i] = p.mag_dT[i] = kNaI16;
  for (uint8_t i = 0; i < 4; ++i) p.q_fus[i] = p.q_triad[i] = kNaI16;
  p.q_fus_acc_mrad = kNaU16;
  if (aru_valid_) {
    const AruReading& r = aru_last_;
    if (r.motion_flags & 1u) {
      p.flags |= ATT_F_QUAT;
      p.q_fus[0] = clamp_i16(r.qw * 16384.0f);
      p.q_fus[1] = clamp_i16(r.qx * 16384.0f);
      p.q_fus[2] = clamp_i16(r.qy * 16384.0f);
      p.q_fus[3] = clamp_i16(r.qz * 16384.0f);
      p.q_fus_acc_mrad = r.quat_acc_mrad;
    }
    if (r.motion_flags & 2u) {
      p.flags |= ATT_F_ACC;
      for (uint8_t i = 0; i < 3; ++i) p.acc_mg[i] = r.acc_mg[i];
    }
    if (r.motion_flags & 4u) {
      p.flags |= ATT_F_GYRO;
      for (uint8_t i = 0; i < 3; ++i) p.gyro_ddps[i] = r.gyro_ddps[i];
    }
    if (r.motion_flags & 8u) {
      p.flags |= ATT_F_MAG;
      for (uint8_t i = 0; i < 3; ++i) p.mag_dT[i] = clamp_i16(last_mag_ut_[i] * 10.0f);
    }
    if (r.motion_flags & 0x10u) p.flags |= ATT_F_MAG_SCALE;   // ARU page 0 flag b4 (C-21)
  }
  Quat q{1.0f, 0.0f, 0.0f, 0.0f};
  bool from_rm = false;
  if (triad(q, from_rm)) {
    p.flags |= ATT_F_TRIAD;
    if (from_rm) p.flags |= ATT_F_TRIAD_RM3100;
    p.q_triad[0] = clamp_i16(q.w * 16384.0f);
    p.q_triad[1] = clamp_i16(q.x * 16384.0f);
    p.q_triad[2] = clamp_i16(q.y * 16384.0f);
    p.q_triad[3] = clamp_i16(q.z * 16384.0f);
  }
  uint8_t b[kAttLen];
  (void)emit(APID_ATT, b, pack_att(p, b), VC_RT_SCI);
}

// ENV (PB-1.11): the ARU environment page as sent by the Nicla Sense ME. ARU flags b0 p,
// b1 BSEC, b2 T, b3 RH, b4 gas -> ENV b0 = b0, b1 = b1, b2 = (b2 | b3) with the missing
// one sent as its sentinel, b3 = b4.
void Flight::gen_env() {
  EnvPacket p{};
  p.p_cPa = kNaU32;
  p.t_cC = kNaI16;
  p.rh_cpct = kNaU16;
  p.iaq = p.iaq_s = kNaU16;
  p.co2eq_ppm = kNaU32;
  p.bvoc_cppm = kNaU16;
  p.gas_ohm = kNaU32;
  if (aru_env_valid_) {
    const AruReading& r = aru_last_;
    const uint8_t ef = r.env_flags;
    if (ef & 0x01u) {
      p.flags |= ENV_F_PRESSURE;
      p.p_cPa = r.p_pa;                             // Pa = 0.01 hPa, unchanged from the page
    }
    if (ef & 0x02u) {
      p.flags |= ENV_F_BSEC;
      p.iaq = r.iaq;
      p.iaq_s = r.iaq_s;
      p.co2eq_ppm = r.co2eq;
      p.bvoc_cppm = clamp_u16(r.bvoc_ppm * 100.0f);
      p.accuracy = r.bsec_accuracy <= 3u ? r.bsec_accuracy : (uint8_t)3u;   // BSEC 0..3
    }
    if (ef & 0x0Cu) {
      p.flags |= ENV_F_TH;
      if (ef & 0x04u) p.t_cC = clamp_i16(r.t_c * 100.0f);
      if (ef & 0x08u) p.rh_cpct = clamp_u16(r.rh * 100.0f);
    }
    if (ef & 0x10u) {
      p.flags |= ENV_F_GAS;
      p.gas_ohm = r.gas_ohm;
    }
  }
  uint8_t b[kEnvLen];
  (void)emit(APID_ENV, b, pack_env(p, b), VC_RT_SCI);
}

// =============================================================================
// Fault protection (1 Hz, PB-8.6 item 7)
// =============================================================================
void Flight::fdir_1hz(uint32_t now) {
  // --- command-loss timer (standard deep-space fault protection) ---
  if (cmd_loss_s_ && now - last_valid_tc_ms_ > cmd_loss_s_ * 1000u) {
    last_valid_tc_ms_ = now;                        // re-arm: one response per period
    fdir_flags_ |= FDIR_CMD_LOSS;
    if (fdir_mask_ & FDIR_CMD_LOSS) {
      evr(3, 0x0601, "COMMAND LOSS: no valid uplink for %lu s -> SAFE, default radio",
          (unsigned long)cmd_loss_s_);
      if (rcfg_.rate_code != kRadioRateCode || rcfg_.channel != kRadioChannel) {
        rcfg_.rate_code = kRadioRateCode;           // fall back to the mission-default link
        rcfg_.channel = kRadioChannel;
        pending_cfg_valid_ = false;
        revert_armed_ = false;
        radio_reconfig_pending_ = true;
      }
      if (hibernating_) exit_hibernate("command loss");
      enter_fdir_safe("command loss");
    }
  }
  // --- radio-change revert ---
  if (revert_armed_ && (int32_t)(now - revert_deadline_ms_) > 0) {
    revert_armed_ = false;
    pending_cfg_valid_ = false;
    rcfg_.rate_code = revert_cfg_.rate_code;
    rcfg_.channel = revert_cfg_.channel;
    radio_reconfig_pending_ = true;
    fdir_flags_ |= FDIR_RATE_REVERT;
    evr(3, 0x0602, "radio change NOT confirmed by uplink - reverting to ch %u code %u",
        (unsigned)revert_cfg_.channel, (unsigned)revert_cfg_.rate_code);
  }
  // --- commanded REBOOT that cannot wait for its 2 frames (C18) ---
  if (reboot_pending_ && (tx_inhibit_ || !radio_cfg_ok_ || (int32_t)(now - reboot_deadline_ms_) >= 0))
    do_reboot(tx_inhibit_ ? "TX inhibited" : !radio_cfg_ok_ ? "radio not configured" : "no frame sent in time");
  // --- TX inhibit timer ---
  if (tx_inhibit_ && (int32_t)(now - tx_inhibit_until_ms_) > 0) {
    tx_inhibit_ = false;
    fdir_flags_ &= (uint16_t)~FDIR_TX_INHIBIT;
    evr(1, 0x0603, "transmitter re-enabled");
  }
  // --- spacecraft bus temperature (Nicla Sense ME) ---
  if (!isnan(bus_temp_c_)) {
    if (bus_temp_c_ >= kBusTempRedC) fdir_flags_ |= FDIR_AVI_OVERTEMP;
    else if (bus_temp_c_ < kBusTempRedC - 5.0f) fdir_flags_ &= (uint16_t)~FDIR_AVI_OVERTEMP;
  }
  // --- instruments missing since boot (or a failed bus clear): re-probe with back-off ---
  reprobe_instruments(now);
  // --- I2C bus: bus clear + re-initialisation, at most once per 10 s ---
  if (bus_.consecutive_errors() > kI2cFdirErrors && (fdir_mask_ & FDIR_I2C_BUS) &&
      (!recovered_once_ || now - last_recover_ms_ >= kBusRecoverMinMs)) {
    fdir_flags_ |= FDIR_I2C_BUS;
    evr(3, 0x0605, "I2C bus fault (%u consecutive errors) - bus clear + re-init",
        (unsigned)bus_.consecutive_errors());
    bus_recover(now, "FDIR");
  }
  // The same for the Qwiic connector (AS7265X only): controller re-initialisation.
  if (qwiic_.consecutive_errors() > kI2cFdirErrors && (fdir_mask_ & FDIR_I2C_BUS) &&
      (!recovered_once_ || now - last_recover_ms_ >= kBusRecoverMinMs)) {
    fdir_flags_ |= FDIR_I2C_BUS;
    evr(3, 0x0605, "Qwiic I2C bus fault (%u consecutive errors) - re-init",
        (unsigned)qwiic_.consecutive_errors());
    recovered_once_ = true;
    last_recover_ms_ = now;
    (void)qwiic_.recover();
  }
  // F-25: FDIR I2C_BUS clears after kI2cBusHealthyS seconds without a new bus error.
  const uint32_t errs = bus_.errors() + qwiic_.errors();
  if (errs != i2c_err_snapshot_) {
    i2c_err_snapshot_ = errs;
    i2c_quiet_s_ = 0;
  } else if (i2c_quiet_s_ < 0xFFFFu) {
    ++i2c_quiet_s_;
  }
  if ((fdir_flags_ & FDIR_I2C_BUS) && i2c_quiet_s_ >= kI2cBusHealthyS) {
    fdir_flags_ &= (uint16_t)~FDIR_I2C_BUS;
    evr(1, 0x0609, "I2C bus healthy again: FDIR I2C_BUS cleared");
  }
  // --- instrument loss: the Nicla Sense ME (read every second) is the bus canary ---
  if (aru_fail_count_ > 5 && (sensor_health_ & SNS_NICLA_ME)) {
    sensor_health_ &= (uint16_t)~(SNS_NICLA_ME | kMeBits);
    fdir_flags_ |= FDIR_SENSOR_LOST;
    // No temperature any more (bus_temp_c_ is NAN): the avionics over-temperature flag
    // cannot be judged and is not kept latched on a stale reading (C22).
    fdir_flags_ &= (uint16_t)~FDIR_AVI_OVERTEMP;
    evr(3, 0x0606, "Nicla Sense ME stopped responding");
  } else if (aru_fail_count_ == 0 && (fdir_flags_ & FDIR_SENSOR_LOST) && (sensor_health_ & SNS_NICLA_ME)) {
    fdir_flags_ &= (uint16_t)~FDIR_SENSOR_LOST;
    evr(1, 0x0607, "Nicla Sense ME responding again");
  }
  // --- downlink congestion: routine packets fill a VC to 768 octets at most (PB-1.2) ---
  const size_t v0 = dl_.backlog(VC_RT_ENG), v1 = dl_.backlog(VC_RT_SCI);
  if (v0 > kVcCongestSetOctets || v1 > kVcCongestSetOctets) fdir_flags_ |= FDIR_VC_CONGEST;
  else if (v0 < kVcCongestClearOctets && v1 < kVcCongestClearOctets) fdir_flags_ &= (uint16_t)~FDIR_VC_CONGEST;
  // --- E22-400T37S abnormal-status reports stop 500 ms after the condition clears ---
  if (radio_fault_code_ >= kRadioFaultUnderVoltage && radio_fault_code_ <= kRadioFaultOvAndOt &&
      now - radio_fault_ms_ > kT37sFaultClearMs) {
    evr(1, 0x0315, "E22 abnormal status cleared (%u reports)", (unsigned)radio_fault_reports_);
    radio_fault_code_ = 0;
    fdir_flags_ &= (uint16_t)~(FDIR_RADIO_FAULT | FDIR_LOW_BUS_V | FDIR_PA_OVERTEMP);
  }
  // --- COP-1 ---
  if (farm_.state() == Farm1::S3_LOCKOUT) fdir_flags_ |= FDIR_FARM_LOCKOUT;
  else fdir_flags_ &= (uint16_t)~FDIR_FARM_LOCKOUT;
  if (loop_overruns_) fdir_flags_ |= FDIR_LOOP_OVERRUN;
}

void Flight::bus_recover(uint32_t now, const char* why) {
  recovered_once_ = true;
  last_recover_ms_ = now;
  LOGF("WARN", "I2C bus recovery (%s)", why);
  bus_clear_failed_ = !bus_.recover();
  if (bus_clear_failed_)
    evr(3, 0x060A, "I2C bus clear: SDA or SCL still low after %u clocks", (unsigned)kI2cClearMaxPulses);
}

// C28: a Nicla Sense ME or RM3100 that missed its one probe at boot (a transient NACK, a
// glitch during REVID / CMM / BIST / CC, a bus clear that failed) was lost until the next
// reboot. Enabled units that are not ok() are probed again, paced like the AS7265X driver
// (ReprobeTimer: 30 s doubling to 10 min), only in a quiet window: PA off, no sample or
// self-test pending, every lamp dark. A failed bus clear is retried first.
void Flight::reprobe_instruments(uint32_t now) {
  if (!reprobe_.due(now)) return;
  if (tx_state_ != TX_IDLE || mag_phase_ != MAG_IDLE || mag_sample_pending_ || bist_pending_ != 0 ||
      spec_.lamps_lit() || spec_.lamp_state_unknown())
    return;
  if (bus_clear_failed_ && (!recovered_once_ || now - last_recover_ms_ >= kBusRecoverMinMs))
    bus_recover(now, "re-probe");
  bool acquired = false;
  if ((sensor_enable_ & SNS_NICLA_ME) && !aru_.ok()) {
    if (aru_.begin(bus_)) {
      acquired = true;
      aru_fail_count_ = 0;
      sensor_health_ |= SNS_NICLA_ME;
      evr(1, 0x060B, "instrument acquired: %s", "Nicla Sense ME");
    }
  }
  for (uint8_t u = 0; u < kMagUnits; ++u) {
    Rm3100& m = u ? mag_ib_ : mag_ob_;
    const uint16_t bit = u ? (uint16_t)SNS_RM3100_IB : (uint16_t)SNS_RM3100_OB;
    if (!(sensor_enable_ & bit) || m.ok()) continue;
    if (m.begin(bus_, u ? kRm3100IbAddr : kRm3100ObAddr, mag_cc_)) {
      acquired = true;
      sensor_health_ |= bit;
      bist_pending_ = (uint8_t)(bist_pending_ | (1u << u));   // self-test in the next quiet window
      bist_wait_t0_ = now;
      evr(1, 0x060B, "instrument acquired: %s", u ? "RM3100 inboard" : "RM3100 outboard");
    }
  }
  reprobe_.done(now, acquired);
}

bool Flight::apply_mag_cc() {
  mag_cc_pending_ = false;
  const bool a = mag_ob_.ok() && mag_ob_.set_cycle_count(mag_cc_);
  const bool b = mag_ib_.ok() && mag_ib_.set_cycle_count(mag_cc_);
  return a || b;
}

void Flight::note_valid_tc(uint32_t now) {
  last_valid_tc_ms_ = now;
  tc_age_s_ = 0;
  tc_age_ref_ms_ = now;
}

// =============================================================================
// Spectrometer (PB-8.6 item 3 "spectrometer"; contract 13, 26, 28)
// =============================================================================
void Flight::service_spec(uint32_t now) {
  const bool pa_keyed = tx_state_ != TX_IDLE;
  spec_.set_poll_budget_us(pa_keyed ? kPaKeyedSpecBudgetUs : kSpecPollBudgetUs);
  // No new lamp exposure while an RM3100 sample or self-test waits (lamps never lit
  // during a magnetometer sample); no new exposure at all while the PA is keyed (§13.2
  // PA-off windows). A BURST, once started, runs through transmissions (C-26).
  spec_.set_lamp_gate(!mag_sample_pending_ && bist_pending_ == 0);
  spec_.set_exposure_gate(!pa_keyed);
  (void)spec_.poll(now);
  drain_burst();
  if (spec_.result_ready() && (spec_.result().mode != SPEC_BURST || spec_.burst_available() == 0))
    handle_spec_result(now);
  // SPECDIAG: one line per pass while VC0 has room (PB-2.6); the driver keeps the next one.
  if (spec_.diag_pending() && dl_.backlog(VC_RT_ENG) + kDiagEvrOctets <= kDiagBacklogMax) {
    char line[kEvrTextMax + 1];
    if (spec_.pop_diag_line(line, sizeof line)) evr(1, 0x0703, "%s", line);
  }
  spec_health(now);
  if (!(sensor_enable_ & SNS_AS7265X)) spec_start_req_ = false;
  if (spec_start_req_ && spec_.state() == As7265x::ST_IDLE && !spec_.result_ready() &&
      spec_.burst_available() == 0 && spec_.start_cycle(spec_cfg_, now)) {
    spec_start_req_ = false;
    if (spec_cfg_.mode == SPEC_BURST) {
      burst_tx_frames_ = 0;
      evr(1, 0x0704, "BURST START n=%u s cycles=%u", (unsigned)spec_cfg_.n, (unsigned)spec_cfg_.burst_cycles);
    }
  }
}

void Flight::drain_burst() {
  for (uint8_t k = 0; k < kBurstPacketsPerPass; ++k) {
    const uint8_t avail = spec_.burst_available();
    // Three samples per packet, or the rest once the burst has ended.
    if (!(avail >= kSpecBurstPerPacket || (avail > 0 && !spec_.burst_active()))) return;
    SpecBurstSample s[kSpecBurstPerPacket];
    const uint8_t n = spec_.burst_pop(s, kSpecBurstPerPacket);
    if (n == 0) return;
    const SpecExposure& ex = spec_.burst_exposure();
    uint8_t b[kMaxPayload];
    uint8_t rice_status = RICE_OK;
    const size_t len = pack_specburst(spec_.burst_t0_ms(), spec_.burst_rate_dhz(), ex.gain_code,
                                      ex.int_cycles, s, n, b, sizeof b, rice_status);
    if (rice_status != RICE_OK && rice_status != RICE_ERR_OVERFLOW)
      evr(2, 0x0704, "BURST rice status %u", (unsigned)rice_status);
    // Recorded in the SSR; the real-time push fails when VC1 is full (overflows(1)).
    if (len) (void)emit(APID_SPECBURST, b, len, VC_RT_SCI);
  }
}

void Flight::handle_spec_result(uint32_t now) {
  (void)now;
  const SpecResult& r = spec_.result();
  SpecAttitude att;
  (void)spec_attitude(att);
  SpecV31 v;
  const SpecEvents e = spec_proc_.process(r, att, sclk_.seconds(), v);
  uint8_t b[kMaxPayload];
  const size_t n = pack_spec_v31(v, b, sizeof b);
  if (n) (void)emit(APID_SPEC, b, n, VC_RT_SCI);
  // F-04: LOCKIN / FLUOR whose lamps all sit on absent slaves -> invalid packet (sent
  // above) and one EVR per configuration.
  if ((r.mode == SPEC_LOCKIN || r.mode == SPEC_FLUOR) && !(r.flags & SPEC_F_VALID) &&
      spec_.last_error() == As7265x::ERR_NO_LAMP && !no_lamp_reported_) {
    no_lamp_reported_ = true;
    evr(2, 0x0707, "AS7265X %s", "no lamp on a present device: LOCKIN/FLUOR invalid");
  }
  if (r.mode == SPEC_BURST) {
    // F-06 / C-26: longest sample read and the frames transmitted while the burst ran.
    evr(1, 0x0704, "BURST END samples=%u rate=%u.%u Hz dropped=%u readmax=%u ms tx=%u",
        (unsigned)r.burst_samples, (unsigned)(r.burst_rate_dhz / 10u), (unsigned)(r.burst_rate_dhz % 10u),
        (unsigned)r.burst_dropped, (unsigned)r.burst_read_max_ms, (unsigned)burst_tx_frames_);
  }
  if (e.spectral_event) {
    const unsigned th = spec_proc_.event_threshold_cdeg();
    evr(1, 0x0701, "spectral event: angle %u.%02u deg (threshold %u.%02u)", (unsigned)(e.angle_cdeg / 100u),
        (unsigned)(e.angle_cdeg % 100u), th / 100u, th % 100u);
  }
  if (e.class_changed)
    evr(1, 0x0702, "light source %s -> %s (%u %%)", spec_class_name(e.old_class),
        spec_class_name(e.new_class), (unsigned)e.conf);
  spec_.consume_result();
}

void Flight::spec_health(uint32_t now) {
  const As7265x::State st = spec_.state();
  // F-07 (AS-PROT-7): the health bit follows the driver at run time.
  if (spec_.ok()) sensor_health_ |= SNS_AS7265X;
  else sensor_health_ &= (uint16_t)~SNS_AS7265X;
  // EVR 0x0707 on the stable states only (INIT / RESET are transitional).
  SpecReport cur = spec_reported_;
  if (spec_.ok()) cur = SPEC_REP_OK;
  else if (st == As7265x::ST_ABSENT) cur = SPEC_REP_ABSENT;
  else if (st == As7265x::ST_FAULT) cur = SPEC_REP_FAULT;
  const bool became_ok = cur == SPEC_REP_OK && spec_reported_ != SPEC_REP_OK;
  const bool entered_fault = cur == SPEC_REP_FAULT && spec_reported_ != SPEC_REP_FAULT;
  if (cur != spec_reported_) {
    spec_reported_ = cur;
    if (cur == SPEC_REP_OK) evr(2, 0x0707, "AS7265X %s", "available again");
    else evr(2, 0x0707, "AS7265X %s", cur == SPEC_REP_ABSENT ? "ABSENT" : "FAULT");
  }
  // LAMP STATE UNKNOWN once per episode: the driver's retries pass through INIT / RESET
  // (lamp_state_unknown() false meanwhile), but the episode ends only when a read-back
  // shows every lamp dark (lamps_lit() false) or the instrument works again.
  if (spec_.lamp_state_unknown() && !spec_unknown_reported_) {
    spec_unknown_reported_ = true;
    evr(2, 0x0707, "AS7265X %s", "LAMP STATE UNKNOWN");
  } else if (spec_unknown_reported_ && (!spec_.lamps_lit() || spec_.ok())) {
    spec_unknown_reported_ = false;
  }
  const bool recovered = spec_.take_recovered();
  if (recovered) evr(2, 0x0705, "AS7265X recovered by soft reset");
  if (recovered || became_ok) report_spec_identity();
  // PB-8.6 item 9 (AS-T6): a hung AS72651 may hold SDA; the FAULT path escalates to the
  // bus clear when the bus itself is failing (rate-limited with the FDIR response).
  if (entered_fault && (!recovered_once_ || now - last_recover_ms_ >= kBusRecoverMinMs)) {
    if (!spec_.on_alt_bus()) {
      if (bus_.consecutive_errors() >= kSpecFaultBusErrors) bus_recover(now, "AS7265X FAULT");
    } else if (qwiic_.consecutive_errors() >= kSpecFaultBusErrors) {
      recovered_once_ = true;                       // the Qwiic bus: re-initialisation only
      last_recover_ms_ = now;
      (void)qwiic_.recover();
    }
  }
}

// Attitude for the SPEC boresight: the Nicla fusion quaternion (device -> ENU world),
// else the TRIAD solution (NED -> body, conjugated to body -> NED).
bool Flight::spec_attitude(SpecAttitude& att) {
  att = SpecAttitude();
  att.bore_body = Vec3{kSpecBoresightBody[0], kSpecBoresightBody[1], kSpecBoresightBody[2]};
  if (aru_valid_ && (aru_last_.motion_flags & 1u)) {
    att.valid = true;
    att.q_body_to_world = Quat{aru_last_.qw, aru_last_.qx, aru_last_.qy, aru_last_.qz};
    att.world = SPEC_WORLD_ENU;
    return true;
  }
  Quat q{1.0f, 0.0f, 0.0f, 0.0f};
  bool from_rm = false;
  if (!triad(q, from_rm)) return false;
  att.valid = true;
  att.q_body_to_world = spec_conj(q);
  att.world = SPEC_WORLD_NED;
  return true;
}

// =============================================================================
// Magnetometers and the ARU (PB-8.6 item 3 "MAG/ARU sampling"; F-04, F-60)
// =============================================================================
void Flight::service_mag(uint32_t now) {
  if (mag_phase_ == MAG_IDLE && mag_cc_pending_) (void)apply_mag_cc();   // a MAGCC deferred by a sample
  if (mag_phase_ == MAG_IDLE) {
    if (!sample_due_) return;
    sample_due_ = false;
    mag_phase_ = MAG_WAIT;
    mag_wait_t0_ = now;
    mag_sample_pending_ = true;                     // closes the lamp gate (service_spec)
  }
  if (mag_phase_ == MAG_WAIT) {
    if (tx_state_ != TX_IDLE) return;               // PA-off windows only
    // Lamps lit or in an unknown state: wait up to kSpecLampDeferMaxMs for them to go
    // dark, then sample anyway and flag it (MAG b4).
    const bool lamp = spec_.lamps_lit() || spec_.lamp_state_unknown();
    if (lamp && now - mag_wait_t0_ < kSpecLampDeferMaxMs) return;
    if (lamp) mag_lamp_ = true;
    start_mag_sample();
    mag_phase_ = MAG_COLLECT;
    mag_collect_t0_ = millis();
    if (mag_pending_[0] || mag_pending_[1]) return;  // conversion ~6.8 ms: collect next passes
  }
  // MAG_COLLECT: one STATUS read per pending unit per pass, bounded by kMagCollectTimeoutMs.
  if (tx_state_ != TX_IDLE) mag_tx_keyed_ = true;
  if (spec_.lamps_lit()) mag_lamp_ = true;
  const bool timeout = now - mag_collect_t0_ >= kMagCollectTimeoutMs;
  for (uint8_t u = 0; u < kMagUnits; ++u) {
    if (!mag_pending_[u]) continue;
    Rm3100& m = u ? mag_ib_ : mag_ob_;
    const int8_t ready = m.poll_drdy();
    if (ready == 0 && !timeout) continue;
    finish_mag_unit(u, m);                          // collect, or end the measurement on error / timeout
  }
  if (!mag_pending_[0] && !mag_pending_[1]) {
    mag_phase_ = MAG_IDLE;
    mag_sample_pending_ = false;
  }
}

// Starts both RM3100 conversions, then reads the two Nicla Sense ME pages while they
// convert (~2 x 3 ms of I2C at 100 kHz), so the ~6.8 ms conversion is hidden.
void Flight::start_mag_sample() {
  const uint16_t en = sensor_enable_;
  const bool ob = (en & SNS_RM3100_OB) && mag_ob_.ok();
  const bool ib = (en & SNS_RM3100_IB) && mag_ib_.ok();
  mag_pending_[0] = ob && mag_ob_.start();
  mag_pending_[1] = ib && mag_ib_.start();
  if (!mag_pending_[0]) rm_fresh_[0] = false;       // disabled, absent or POLL failed
  if (!mag_pending_[1]) rm_fresh_[1] = false;
  if ((en & SNS_NICLA_ME) && aru_.ok()) {
    AruReading r = aru_last_;
    if (aru_.read_motion(r)) {
      aru_valid_ = true;
      aru_fail_count_ = 0;
      if (r.motion_flags & 8u) {                    // BMM150 through the BHI260
        for (uint8_t k = 0; k < 3; ++k) last_mag_ut_[k] = (float)r.mag_raw[k] * kAruMagUtPerLsb;
        mstat_body_.add(last_mag_ut_[0], last_mag_ut_[1], last_mag_ut_[2]);
      }
      aru_env_valid_ = aru_.read_env(r);
      // Only a fresh T reading is a bus temperature; anything else is "unknown" (NAN ->
      // HK kNaI16, FDIR skips the check) instead of the last value forever (C22).
      bus_temp_c_ = (aru_env_valid_ && (r.env_flags & 4u)) ? r.t_c : NAN;
      aru_last_ = r;
      sensor_health_ = (uint16_t)((sensor_health_ & ~kMeBits) | SNS_NICLA_ME |
                                  me_bits(r.motion_flags, aru_env_valid_ ? r.env_flags : 0u));
    } else {
      aru_valid_ = aru_env_valid_ = false;
      bus_temp_c_ = NAN;
      if (aru_fail_count_ < 255u) ++aru_fail_count_;
    }
  } else {
    aru_valid_ = aru_env_valid_ = false;            // disabled: no stale attitude or environment
    bus_temp_c_ = NAN;
  }
}

void Flight::finish_mag_unit(uint8_t unit, Rm3100& m) {
  float x = 0.0f, y = 0.0f, z = 0.0f;
  const bool ok = m.collect(x, y, z, 0);            // one STATUS read, never a wait
  mag_pending_[unit] = false;
  rm_fresh_[unit] = ok;
  if (!ok) return;
  rm_ut_[unit][0] = x;
  rm_ut_[unit][1] = y;
  rm_ut_[unit][2] = z;
  if (unit) mstat_ib_.add(x, y, z);
  else mstat_ob_.add(x, y, z);
}

// MAGBIST / deferred boot self-test: one unit per pass, PA off, no magnetometer sample in
// progress, every lamp dark. A lamp whose state stays UNKNOWN (driver FAULT) is waited for
// at most kSpecLampDeferMaxMs, as for a sample.
void Flight::service_bist(uint32_t now) {
  if (!bist_pending_ || tx_state_ != TX_IDLE || mag_phase_ != MAG_IDLE) return;
  if (spec_.lamps_lit() && !(spec_.lamp_state_unknown() && now - bist_wait_t0_ >= kSpecLampDeferMaxMs))
    return;
  const uint8_t unit = (bist_pending_ & 1u) ? 0u : 1u;
  bist_pending_ = (uint8_t)(bist_pending_ & ~(1u << unit));
  run_bist_unit(unit);
}

// =============================================================================
// CFDP (PB-2.5)
// =============================================================================
void Flight::service_cfdp(uint32_t now) {
  // SSR export: at most one PDU per pass, and only while VC3 has room for the largest
  // possible next packet (VC3 never holds more than two packets).
  if (cfdp_tx_.active() &&
      dl_.backlog(VC_FILE) + kSpPriHdrLen + kSpSecHdrLen + kCfdpMaxPduLen <= kCfdpVc3BacklogMax) {
    uint8_t pdu[kCfdpMaxPduLen];
    const size_t n = cfdp_tx_.next_pdu(pdu, sizeof pdu);
    if (n) (void)emit(APID_CFDP, pdu, n, VC_FILE, false);   // a copy of a file: not recorded
  }
  if (cfdp_ssr_active_ && !cfdp_tx_.active()) {
    cfdp_ssr_active_ = false;
    ssr_.end_export();                              // recording resumes
    cfdp_last_seq_ = cfdp_tx_.seq();
    cfdp_last_pm_ = cfdp_tx_.progress_permille();
    evr(1, 0x0A01, "CFDP EOF cond %u: %lu/%lu B, %lu not recorded", (unsigned)cfdp_tx_.last_condition(),
        (unsigned long)cfdp_tx_.sent(), (unsigned long)cfdp_tx_.file_size(),
        (unsigned long)(ssr_.paused_drops() - cfdp_paused_base_));
  }
  // Relay supervision: start, silence and cancel timeouts.
  const RelayGate::Event ev = relay_gate_.poll(now, kRelayStartTimeoutMs);
  if (ev == RelayGate::EV_START_TIMEOUT) {
    evr(2, 0x0A04, "CFDP relay seq %lu: %s", (unsigned long)relay_gate_.seq(), "EGSE did not start within 30 s");
  } else if (ev == RelayGate::EV_CANCEL_TIMEOUT) {
    evr(2, 0x0A04, "CFDP relay seq %lu: %s", (unsigned long)relay_gate_.seq(), "cancelled, no EOF within 30 s");
  }
  if (relay_gate_.state() == RelayGate::ACTIVE && relay_.expired(now)) {
    cfdp_last_seq_ = relay_gate_.seq();
    cfdp_last_pm_ = relay_.progress_permille();
    relay_.reset();
    relay_gate_.reset();
    evr(2, 0x0A04, "CFDP relay seq %lu: %s", (unsigned long)cfdp_last_seq_, "silent, expired");
  }
}

// =============================================================================
// EGSE services (PB-4.1): Router Bridge handlers and the services they run
// =============================================================================
// ---- Router Bridge handlers: post to the mailbox, or run directly on the loop thread ----
bool Flight::rpc_set_partition(int p) {
  if (rpc_.on_loop_thread()) return egse_set_partition(p);
  int32_t r = 0;
  return rpc_.call(RPC_SET_PARTITION, (int32_t)p, nullptr, 0, r) && r != 0;
}

bool Flight::rpc_set_sdls_sn(int sn) {
  if (rpc_.on_loop_thread()) return egse_set_sdls_sn(sn);
  int32_t r = 0;
  return rpc_.call(RPC_SET_SDLS_SN, (int32_t)sn, nullptr, 0, r) && r != 0;
}

bool Flight::rpc_hardline_cltu(const char* hex, size_t len) {
  if (rpc_.on_loop_thread()) return egse_hardline_cltu(hex, len);
  int32_t r = 0;
  return rpc_.call(RPC_HL_CLTU, 0, hex, len, r) && r != 0;   // > 220 characters: false at once
}

int Flight::rpc_cfdp_pdu(const char* hex, size_t len) {
  if (rpc_.on_loop_thread()) return egse_cfdp_pdu(hex, len);
  if (len > kRpcTextMax) return -1;                         // malformed: the loop would refuse it
  int32_t r = 0;
  return rpc_.call(RPC_CFDP_PDU, 0, hex, len, r) ? (int)r : 0;   // not run: busy, the EGSE retries
}

void Flight::service_rpc() {
  const RpcRequest* q = rpc_.take();
  if (q == nullptr) return;
  int32_t r = 0;
  switch (q->op) {
    case RPC_SET_PARTITION: r = egse_set_partition((int)q->arg) ? 1 : 0; break;
    case RPC_SET_SDLS_SN: r = egse_set_sdls_sn((int)q->arg) ? 1 : 0; break;
    case RPC_HL_CLTU: r = egse_hardline_cltu(q->text, q->len) ? 1 : 0; break;
    case RPC_CFDP_PDU: r = egse_cfdp_pdu(q->text, q->len); break;
    default: break;
  }
  rpc_.complete(r);
}

bool Flight::egse_set_partition(int p) {
  if (p < 1 || p > 65534) {
    evr(2, 0x0122, "SDLS TM epoch %ld refused (current %u)", (long)p, (unsigned)sdls_tm_.epoch());
    return false;
  }
  const uint16_t e = (uint16_t)p;
  const uint16_t before = sdls_tm_.epoch();
  // Nonce safety: an epoch is never lowered (a lower one = a regressed EGSE counter).
  if (!sdls_tm_.set_epoch(e)) {
    evr(2, 0x0122, "SDLS TM epoch %ld refused (current %u)", (long)p, (unsigned)before);
    return false;
  }
  sclk_.partition = e;
  if (e != before && sdls_tm_.service() == SDLS_SVC_AE)
    evr(1, 0x0120, "SDLS TM epoch %u: downlink protected", (unsigned)e);
  return true;
}

bool Flight::egse_set_sdls_sn(int sn) {
  sdls_tc_.set_last_sn((uint32_t)sn);               // modulo 2^32: the EGSE's int32 of the u32 SN
  return true;
}

bool Flight::egse_hardline_cltu(const char* hex, size_t len) {
  uint8_t b[110];                                   // hl_cltu: <= 220 hex characters
  const size_t n = hex_decode(hex, len, b, sizeof b, 2, 220);
  if (n == 0) return false;
  LOGF("INFO", "hardline (umbilical) CLTU, %u octets", (unsigned)n);
  process_tc(b, n, true, true);
  return true;
}

int Flight::egse_cfdp_pdu(const char* hex, size_t len) {
  uint8_t pdu[kCfdpRelayMaxPduLen];
  const size_t n = hex_decode(hex, len, pdu, sizeof pdu, 2 * kCfdpHdrLen, 2 * kCfdpRelayMaxPduLen);
  if (n == 0) return -1;                            // bad hex or length
  // Busy (retry): VC3 lacks room for this packet, or SDLS TM waits for its epoch.
  if (!sdls_tm_.ready() || dl_.backlog(VC_FILE) + kSpPriHdrLen + kSpSecHdrLen + n > kCfdpVc3BacklogMax) return 0;
  const uint32_t now = millis();
  if (relay_gate_.admit(pdu, n, now) != 1) return -1;   // not the authorised transfer (counted)
  if (!emit(APID_CFDP, pdu, n, VC_FILE, false)) return 0;
  relay_.observe(pdu, n, now);
  if (relay_gate_.state() == RelayGate::NONE) {     // the admitted PDU was the EOF
    cfdp_last_seq_ = relay_gate_.seq();
    cfdp_last_pm_ = relay_.progress_permille();
    evr(1, 0x0A05, "CFDP relay seq %lu EOF cond %u", (unsigned long)relay_gate_.seq(),
        (unsigned)relay_.last_condition());
  }
  return 1;
}

// =============================================================================
// EGSE notifications (PB-0.4): never wait for the router UART
// =============================================================================
bool Flight::notify_room(size_t payload_octets) const {
  const int room = VGQ_ROUTER_SERIAL.availableForWrite();
  const size_t need = payload_octets + kNotifyMargin + kRpcResponseReserve;
#if VGQ_SMALL_SERIAL_RINGS
  // 64-octet rings (config.h): a notification longer than the ring could never find room,
  // so it goes into an EMPTY ring and Bridge.notify() waits in ZephyrSerial::write() until
  // all but the last ring-full is out: at 115200 bit/s (11.5 octets/ms) at most ~45 ms for
  // the longest (sc_status, tm_cadu; one per pass, large_sent_). Meanwhile the bridge
  // thread (priority 5) keeps reading the router link and the UART pump (6) the radio
  // port; the loop runs at 14 (CONFIG_MAIN_THREAD_PRIORITY).
  if (need > (size_t)CONFIG_ARDUINO_API_SERIAL_BUFFER_SIZE) return room >= CONFIG_ARDUINO_API_SERIAL_BUFFER_SIZE;
#endif
  return room > 0 && (size_t)room >= need;
}

bool Flight::send_cadu(const uint8_t* cadu) {
  if (large_sent_ || !notify_room(kCaduHexLen)) return false;
  Bridge.notify("tm_cadu", to_hex(cadu, kCaduLen));
  large_sent_ = true;
  return true;
}

// One pending copy: the older one leaves first; a third while one waits is dropped.
void Flight::queue_cadu_copy(const uint8_t* cadu) {
  if (cadu_copy_valid_) {
    if (send_cadu(cadu_copy_)) {
      memcpy(cadu_copy_, cadu, kCaduLen);
    } else {
      ++cadu_nd_;
    }
    return;
  }
  if (!send_cadu(cadu)) {
    memcpy(cadu_copy_, cadu, kCaduLen);
    cadu_copy_valid_ = true;
  }
}

void Flight::flush_notifications(uint32_t now) {
  (void)now;
  // Small notifications first (a few dozen octets each, not "large").
  if (boot_note_pending_ && notify_room(8)) {
    Bridge.notify("sc_boot", (int)reset_cause_);
    boot_note_pending_ = false;
  }
  if (sdls_sn_pending_ && notify_room(16)) {
    Bridge.notify("sdls_sn", (int)as_i32(sdls_tc_.last_sn()));   // the latest value is enough
    sdls_sn_pending_ = false;
  }
  if (cfdp_req_pending_) {
    const size_t n = strlen(cfdp_req_text_);
    if (notify_room(n)) {
      Bridge.notify("cfdp_req", text_string(cfdp_req_text_, n));
      cfdp_req_pending_ = false;
    }
  }
  if (cfdp_cancel_pending_) {
    char t[12];
    const int n = snprintf(t, sizeof t, "%lu", (unsigned long)cfdp_cancel_seq_);
    if (n > 0 && (size_t)n < sizeof t && notify_room((size_t)n)) {
      Bridge.notify("cfdp_cancel", text_string(t, (size_t)n));
      cfdp_cancel_pending_ = false;
    }
  }
  // Large notifications: at most one per pass.
  if (cadu_copy_valid_ && send_cadu(cadu_copy_)) cadu_copy_valid_ = false;
  if ((status_due_ || status_x_due_) && !large_sent_) {
    EgseStatus s;
    fill_status(s);
    char j[kEgseStatusCap];
    if (status_due_) {
      const size_t n = format_sc_status(s, j, sizeof j);
      if (n == 0) {
        status_due_ = false;                        // cannot be formatted: nothing to send
      } else if (notify_room(n)) {
        Bridge.notify("sc_status", text_string(j, n));
        large_sent_ = true;
        status_due_ = false;
      }
    }
    if (status_x_due_ && !large_sent_) {
      const size_t n = format_sc_status_x(s, j, sizeof j);
      if (n == 0) {
        status_x_due_ = false;
      } else if (notify_room(n)) {
        Bridge.notify("sc_status_x", text_string(j, n));
        large_sent_ = true;
        status_x_due_ = false;
      }
    }
  }
}

void Flight::fill_status(EgseStatus& s) {
  s = EgseStatus();
  s.mode = mode_;
  s.sclk = sclk_.seconds();
  s.part = sclk_.partition;
  s.epoch = sdls_tm_.epoch();
  s.tm_state = sdls_tm_.state();
  s.tm_sn = sdls_tm_.last_sn();
  s.frames = frames_sent_;
  s.oid = oid_sent_;
  s.mcfc = dl_.mcfc();
  s.period_ms = hibernating_ ? (uint32_t)beacon_s_ * 1000u : period_now_ms();
  s.busy_ms = last_airtime_ms_;
  s.duty_pct = (float)duty_permille(millis()) / 10.0f;
  s.model = radio_.model();
  s.fr = dl_.framing() == FRAMING_USLP ? 1u : 0u;
  s.ch = rcfg_.channel;
  s.code = rcfg_.rate_code;
  s.pwr = rcfg_.power_code;
  s.lbt = rcfg_.lbt;
  s.tx = tx_state_ != TX_IDLE;
  s.inhibit = tx_inhibit_;
  s.hib = hibernating_;
  s.beacon = beacon_.level();
  s.ul_rssi = uplink_rssi_;
  s.ul_snr_cdb = uplink_snr_cdb_;
  s.noise = noise_dbm_;
  s.farm = farm_.state();
  s.vr = farm_.vr();
  s.acc = cmd_acc_;
  s.rej = cmd_rej_;
  s.fdir = fdir_flags_;
  s.sns = sensor_health_;
  for (uint8_t v = 0; v < 4; ++v) s.vc[v] = sat16((uint32_t)dl_.backlog(v));
  s.ssr_pm = ssr_.fill_permille();
  s.bus_c = bus_temp_c_;
  s.rf_fault = radio_fault_code_;
  s.tc_svc = sdls_tc_.service();
  s.tm_svc = sdls_tm_.service();
  cfdp_hk(s.cfdp, s.cfdp_seq, s.cfdp_pm);
  s.seq = seq_.state();
  s.tc_rescued = tc_rescued_;
  s.evr_nd = evr_nd_;
  s.cadu_nd = cadu_nd_;
  s.emit_ref = emit_refused_;
  s.relay_ref = relay_gate_.refused();
  s.stretch = load_.stretch_x100;
}

// =============================================================================
// Status display (4 Hz)
// =============================================================================
void Flight::update_display(uint32_t now) {
  ScDisplayData d{};
  d.mode = mode_;
  d.tx_on = tx_state_ != TX_IDLE;
  d.rx_flash = now - last_rx_flash_ms_ < kRxFlashMs;
  d.farm_lockout = farm_.state() == Farm1::S3_LOCKOUT;
  d.fdir_active = (fdir_flags_ & (uint16_t)~(FDIR_TX_INHIBIT | FDIR_HIBERNATE)) != 0;
  d.vc0_pm = permille_of_vc(dl_.backlog(VC_RT_ENG));
  d.vc1_pm = permille_of_vc(dl_.backlog(VC_RT_SCI));
  d.ssr_pm = ssr_.fill_permille();
  d.sensor_health = sensor_health_;
  d.beacon = beacon_.level();
  display_.update(d);
}

}  // namespace vgq
